# PIC16F1939 register map
Vendor: Microchip
Architecture 16Exxx. Special function registers and configuration words.
Registers are 8-bit, read-write, reset 0x0 unless marked. A register's access mark holds for its fields unless they carry their own. Addresses are absolute, and some are shared; only a register's first bit layout is shown; lines under a group give offsets from that group; [hi:lo] are bit positions; {n}, {i} and the like mark numbered series; 'fields as' and 'values as' point back to an identical list; <NAME> marks a mode.

## Further device data
pins=1: RE3/MCLR/Vpp; 2: RA0/AN0/C12IN0-/C2OUT/SRNQ/SS/Vcap/SEG12; 3: RA1/AN1/C12IN1-/SEG7; 4: RA2/AN2/C2IN+/Vref-/DACOUT/COM2; 5: RA3/AN3/C1IN+/Vref+/SEG15; 6: RA4/C1OUT/CPS6/T0CKI/SRQ/SEG4; 7: RA5/AN4/C2OUT/CPS7/SRNQ/SS/Vcap/SEG5; 8: RE0/AN5/P3A/CCP3/SEG21; 9: RE1/AN6/P3B/SEG22; 10: RE2/AN7/CCP5/SEG23; 11: Vdd; 12: Vss; 13: RA7/OSC1/CLKIN/SEG2; 14: RA6/OSC2/CLKOUT/Vcap/SEG1; 15: RC0/T1OSO/T1CKI/P2B; 16: RC1/T1OSI/CCP2/P2A; 17: RC2/CCP1/P1A/SEG3; 18: RC3/SCL/SCK/SEG6; 19: RD0/CPS8/COM3; 20: RD1/CPS9/CCP4; 21: RD2/CPS10/P2B; 22: RD3/CPS11/P2C/SEG16; 23: RC4/SDI/SDA/T1G/SEG11; 24: RC5/SDO/SEG10; 25: RC6/TX/CK/SEG9; 26: RC7/RX/DT/SEG8; 27: RD4/CPS12/P2D/SEG17; 28: RD5/CPS13/P1B/SEG18; 29: RD6/CPS14/P1C/SEG19; 30: RD7/CPS15/P1D/SEG20; 31: Vss; 32: Vdd; 33: RB0/AN12/CPS0/SRI/INT/SEG0; 34: RB1/AN10/C12IN3-/CPS1/VLCD1; 35: RB2/AN8/CPS2/VLCD2; 36: RB3/AN9/C12IN2-/CPS3/CCP2/P2A/VLCD3; 37: RB4/AN11/CPS4/COM0; 38: RB5/AN13/CPS5/CCP3/P3A/T1G/COM1; 39: RB6/ICSPCLK/ICDCLK/SEG14; 40: RB7/ICSPDAT/ICDDAT/SEG13

## CONFIG — Configuration words, addresses in ProgramSpace
0x8007 CONFIG1 14-bit reset 0x3FFF
  [13] FCMEN — Fail-Safe Clock Monitor Enable
    1=ON (Fail-Safe Clock Monitor is enabled); 0=OFF (Fail-Safe Clock Monitor is disabled)
  [12] IESO — Internal/External Switchover
    1=ON (Internal/External Switchover mode is enabled); 0=OFF (Internal/External Switchover mode is disabled)
  [11] CLKOUTEN — Clock Out Enable
    1=OFF (CLKOUT function is disabled. I/O or oscillator function on the CLKOUT pin); 0=ON (CLKOUT function is enabled on the CLKOUT pin)
  [10:9] BOREN — Brown-out Reset Enable
    3=ON (Brown-out Reset enabled); 2=NSLEEP (Brown-out Reset enabled while running and disabled in Sleep); 1=SBODEN (Brown-out Reset controlled by the SBOREN bit in the BORCON register); 0=OFF (Brown-out Reset disabled)
  [8] CPD — Data Memory Code Protection
    1=OFF (Data memory code protection is disabled); 0=ON (Data memory code protection is enabled)
  [7] CP — Flash Program Memory Code Protection
    1=OFF (Program memory code protection is disabled); 0=ON (Program memory code protection is enabled)
  [6] MCLRE — MCLR Pin Function Select
    1=ON (MCLR/VPP pin function is MCLR); 0=OFF (MCLR/VPP pin function is digital input)
  [5] PWRTE — Power-up Timer Enable
    1=OFF (PWRT disabled); 0=ON (PWRT enabled)
  [4:3] WDTE — Watchdog Timer Enable
    3=ON (WDT enabled); 2=NSLEEP (WDT enabled while running and disabled in Sleep); 1=SWDTEN (WDT controlled by the SWDTEN bit in the WDTCON register); 0=OFF (WDT disabled)
  [2:0] FOSC — Oscillator Selection
    7=ECH (ECH, External Clock, High Power Mode (4-32 MHz): device clock supplied to CLKIN pin); 6=ECM (ECM, External Clock, Medium Power Mode (0.5-4 MHz): device clock supplied to CLKIN pin); 5=ECL (ECL, External Clock, Low Power Mode (0-0.5 MHz): device clock supplied to CLKIN pin); 4=INTOSC (INTOSC oscillator: I/O function on CLKIN pin); 3=EXTRC (EXTRC oscillator: External RC circuit connected to CLKIN pin); 2=HS (HS Oscillator, High-speed crystal/resonator connected between OSC1 and OSC2 pins); 1=XT (XT Oscillator, Crystal/resonator connected between OSC1 and OSC2 pins); 0=LP (LP Oscillator, Low-power crystal connected between OSC1 and OSC2 pins)
0x8008 CONFIG2 14-bit reset 0x3FFF
  [13] LVP — Low-Voltage Programming Enable
    1=ON (Low-voltage programming enabled); 0=OFF (High-voltage on MCLR/VPP must be used for programming)
  [12] DEBUG — In-Circuit Debugger Mode
    1=OFF (In-Circuit Debugger disabled, ICSPCLK and ICSPDAT are general purpose I/O pins); 0=ON (In-Circuit Debugger enabled, ICSPCLK and ICSPDAT are dedicated to the debugger)
  [10] BORV — Brown-out Reset Voltage Selection
    1=LO (Brown-out Reset Voltage (Vbor), low trip point selected.); 0=HI (Brown-out Reset Voltage (Vbor), high trip point selected.)
  [9] STVREN — Stack Overflow/Underflow Reset Enable
    1=ON (Stack Overflow or Underflow will cause a Reset); 0=OFF (Stack Overflow or Underflow will not cause a Reset)
  [8] PLLEN — PLL Enable
    1=ON (4x PLL enabled); 0=OFF (4x PLL disabled)
  [5:4] VCAPEN — Voltage Regulator Capacitor Enable
    3=OFF (All VCAP pin functionality is disabled); 2=RA6 (VCAP functionality is enabled on RA6); 1=RA5 (VCAP functionality is enabled on RA5); 0=RA0 (VCAP functionality is enabled on RA0)
  [1:0] WRT — Flash Memory Self-Write Protection
    3=OFF (Write protection off); 2=BOOT (000h to 1FFh write protected, 200h to 3FFFh may be modified by EECON control); 1=HALF (000h to 1FFFh write protected, 2000h to 3FFFh may be modified by EECON control); 0=ALL (000h to 3FFFh write protected, no addresses may be modified by EECON control)
