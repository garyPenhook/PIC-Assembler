# PIC16F1527 register map
Vendor: Microchip
Architecture 16Exxx. Special function registers and configuration words.
Registers are 8-bit, read-write, no defined reset value unless marked. A register's access mark holds for its fields unless they carry their own. Addresses are absolute, and some are shared; only a register's first bit layout is shown; lines under a group give offsets from that group; [hi:lo] are bit positions; {n}, {i} and the like mark numbered series; 'fields as' and 'values as' point back to an identical list; <NAME> marks a mode.

## Further device data
pins=1: RE1/AN28; 2: RE0/AN27; 3: RG0/CCP3; 4: RG1/AN15/TX2/CK2; 5: RG2/AN14/RX2/DT2; 6: RG3/AN13/CCP4; 7: RG5/MCLR/Vpp; 8: RG4/AN12/T5G/CCP5; 9: Vss; 10: Vdd; 11: RF7/AN5/SS1; 12: RF6/AN11; 13: RF5/AN10; 14: RF4/AN9; 15: RF3/AN8; 16: RF2/AN7; 17: RF1/AN6; 18: RF0/AN16/Vcap; 19: AVdd; 20: AVss; 21: RA3/AN3/Vref+; 22: RA2/AN2; 23: RA1/AN1; 24: RA0/AN0; 25: Vss; 26: Vdd; 27: RA5/AN4/T3G; 28: RA4/T0CKI; 29: RC1/SOSCI/CCP2; 30: RC0/SOSCO/T1CKI; 31: RC6/TX1/CK1; 32: RC7/RX1/DT1; 33: RC2/CCP1; 34: RC3/SCK1/SCL1; 35: RC4/SDI1/SDA1; 36: RC5/SDO1; 37: RB7/ICSPDAT/ICDDAT; 38: Vdd; 39: RA7/OSC1/CLKIN; 40: RA6/OSC2/CLKOUT; 41: Vss; 42: RB6/ICSPCLK/ICDCLK; 43: RB5/AN22/T1G/T3CKI; 44: RB4/AN21/T3CKI; 45: RB3/AN20; 46: RB2/AN19; 47: RB1/AN18; 48: RB0/AN17/INT; 49: RD7/SS2; 50: RD6/SCK2/SCL2; 51: RD5/SDI2/SDA2; 52: RD4/SDO2; 53: RD3/AN26; 54: RD2/AN25; 55: RD1/AN24/T5CKI; 56: Vss; 57: Vdd; 58: RD0/AN23; 59: RE7/CCP2; 60: RE6/CCP6; 61: RE5/CCP7; 62: RE4/CCP8; 63: RE3/CCP9; 64: RE2/AN29/CCP10

## CONFIG — Configuration words, addresses in ProgramSpace
0x8007 CONFIG1 14-bit reset 0x3FFF
  [13] FCMEN — Fail-Safe Clock Monitor Enable
    1=ON (Fail-Safe Clock Monitor is enabled); 0=OFF (Fail-Safe Clock Monitor is disabled)
  [12] IESO — Internal/External Switchover
    1=ON (Internal/External Switchover mode is enabled); 0=OFF (Internal/External Switchover mode is disabled)
  [11] CLKOUTEN — Clock Out Enable
    1=OFF (CLKOUT function is disabled. I/O or oscillator function on the CLKOUT pin); 0=ON (CLKOUT function is enabled on the CLKOUT pin)
  [10:9] BOREN — Brown-out Reset Enable
    3=ON (Brown-out Reset enabled); 2=NSLEEP (Brown-out Reset enabled while running and disabled in Sleep); 1=SBODEN (Brown-out Reset controlled by the SBOREN bit in the BORCON register); 0=OFF (Brown-out Reset disabled)
  [7] CP — Flash Program Memory Code Protection
    1=OFF (Program memory code protection is disabled); 0=ON (Program memory code protection is enabled)
  [6] MCLRE — MCLR Pin Function Select
    1=ON (MCLR/VPP pin function is MCLR); 0=OFF (MCLR/VPP pin function is digital input)
  [5] PWRTE — Power-up Timer Enable
    1=OFF (PWRT disabled); 0=ON (PWRT enabled)
  [4:3] WDTE — Watchdog Timer Enable
    3=ON (WDT enabled); 2=NSLEEP (WDT enabled while running and disabled in Sleep); 1=SWDTEN (WDT controlled by the SWDTEN bit in the WDTCON register); 0=OFF (WDT disabled)
  [2:0] FOSC — Oscillator Selection
    7=ECH (ECH, External Clock, High Power Mode (4-20 MHz): device clock supplied to CLKIN pin); 6=ECM (ECM, External Clock, Medium Power Mode (0.5-4 MHz): device clock supplied to CLKIN pin); 5=ECL (ECL, External Clock, Low Power Mode (0-0.5 MHz): device clock supplied to CLKIN pin); 4=INTOSC (INTOSC oscillator: I/O function on CLKIN pin); 3=EXTRC (EXTRC oscillator: External RC circuit connected to CLKIN pin); 2=HS (HS Oscillator, High-speed crystal/resonator connected between OSC1 and OSC2 pins); 1=XT (XT Oscillator, Crystal/resonator connected between OSC1 and OSC2 pins); 0=LP (LP Oscillator, Low-power crystal connected between OSC1 and OSC2 pins)
0x8008 CONFIG2 14-bit reset 0x3FFF
  [13] LVP — Low-Voltage Programming Enable
    1=ON (Low-voltage programming enabled); 0=OFF (High-voltage on MCLR/VPP must be used for programming)
  [12] DEBUG — In-Circuit Debugger Mode
    1=OFF (In-Circuit Debugger disabled, ICDCLK and ICDDAT are general purpose I/O pins); 0=ON (In-Circuit Debugger enabled, ICDCLK and ICDDAT are dedicated to the debugger)
  [11] LPBOR — Low-Power Brown Out Reset
    1=OFF (Low-Power BOR is disabled); 0=ON (Low-Power BOR is enabled)
  [10] BORV — Brown-out Reset Voltage Selection
    1=LO (Brown-out Reset Voltage (Vbor), low trip point selected.); 0=HI (Brown-out Reset Voltage (Vbor), high trip point selected.)
  [9] STVREN — Stack Overflow/Underflow Reset Enable
    1=ON (Stack Overflow or Underflow will cause a Reset); 0=OFF (Stack Overflow or Underflow will not cause a Reset)
  [4] VCAPEN — Voltage Regulator Capacitor Enable bit
    1=OFF (VCAP pin function disabled); 0=ON (VCAP pin function enabled)
  [1:0] WRT — Flash Memory Self-Write Protection
    3=OFF (Write protection off); 2=BOOT (000h to 1FFh write protected, 200h to 3FFFh may be modified by PMCON control); 1=HALF (000h to FFFh write protected, 2000h to 3FFFh may be modified by PMCON control); 0=ALL (000h to 3FFFh write protected, no addresses may be modified by PMCON control)
