# PIC16LF1559 register map
Vendor: Microchip
Architecture 16Exxx. Special function registers and configuration words.
Registers are 8-bit, read-write, no defined reset value unless marked. A register's access mark holds for its fields unless they carry their own. Addresses are absolute, and some are shared; only a register's first bit layout is shown; lines under a group give offsets from that group; [hi:lo] are bit positions; {n}, {i} and the like mark numbered series; 'fields as' and 'values as' point back to an identical list; <NAME> marks a mode.

## Further device data
pins=1: VDD; 2: RA5/IOCA5/T1CKI/AN20/CLKIN; 3: RA4/IOCA4/T1G/ADTRIG/AN10/CLKOUT; 4: RA3/IOCA3/SS/SDI/SDA/MCLR/ICDMCLR/VPP; 5: RC5/AD2GRDA/AD1GRDA/AN21; 6: RC4/AD2GRDA/AD1GRDA/AN11; 7: RC3/AD2GRDB/AD1GRDB/PWM2/AN22; 8: RC6/SS/AN14; 9: RC7/SDO/AN24; 10: RB7/IOCB7/TX/CK/AN15; 11: RB6/IOCB6/SCK/SCL/AN25; 12: RB5/IOCB5/RX/DT/AN16; 13: RB4/IOCB4/SDI/SDA/AN26; 14: RC2/AD2GRDB/AD1GRDB/PWM1/AN12; 15: RC1/AN23; 16: RC0/AN13; 17: RA2/IOCA2/INT/T0CKI/AN2; 18: RA1/IOCA1/VREFADC/ICDCLK/ICSPCLK; 19: RA0/IOCA0/AN0/ICDDAT/ICSPDAT; 20: VSS

## CONFIG — Configuration words, addresses in ProgramSpace
0x8007 CONFIG1 14-bit reset 0x3FFF
  [11] CLKOUTEN — Clock Out Enable
    1=OFF (CLKOUT function is disabled. I/O or oscillator function on the CLKOUT pin); 0=ON (CLKOUT function is enabled on the CLKOUT pin)
  [10:9] BOREN — Brown-out Reset Enable
    3=ON (Brown-out Reset enabled); 2=NSLEEP (Brown-out Reset enabled while running and disabled in Sleep. SBOREN bit is ignored.); 1=SBODEN (Brown-out Reset controlled by the SBOREN bit in the BORCON register); 0=OFF (Brown-out Reset disabled. SBOREN bit is ignored.)
  [7] CP — Flash Program Memory Code Protection
    1=OFF (Program memory code protection is disabled); 0=ON (Program memory code protection is enabled)
  [6] MCLRE — MCLR Pin Function Select
    1=ON (MCLR/VPP pin function is MCLR); 0=OFF (MCLR/VPP pin function is digital input)
  [5] PWRTE — Power-up Timer Enable
    1=OFF (PWRT disabled); 0=ON (PWRT enabled)
  [4:3] WDTE — Watchdog Timer Enable
    3=ON (WDT enabled. SWDTEN bit is ignored.); 2=NSLEEP (WDT enabled while running and disabled in Sleep. SWDTEN bit is ignored.); 1=SWDTEN (WDT controlled by the SWDTEN bit in the WDTCON register); 0=OFF (WDT disabled. SWDTEN bit is ignored.)
  [1:0] FOSC — Oscillator Selection Bits
    3=ECH (ECH, External Clock, High Power Mode (4-20 MHz): device clock supplied to CLKIN pins); 2=ECM (ECM, External Clock, Medium Power Mode (0.5-4 MHz): device clock supplied to CLKIN pins); 1=ECL (ECL, External Clock, Low Power Mode (0-0.5 MHz): device clock supplied to CLKIN pins); 0=INTOSC (INTOSC oscillator: I/O function on CLKIN pin)
0x8008 CONFIG2 14-bit reset 0x3FFF
  [13] LVP — Low-Voltage Programming Enable
    1=ON (Low-voltage programming enabled); 0=OFF (High-voltage on MCLR/VPP must be used for programming)
  [12] DEBUG — In-Circuit Debugger Mode
    1=OFF (In-Circuit Debugger disabled, ICSPCLK and ICSPDAT are general purpose I/O pins); 0=ON (In-Circuit Debugger enabled, ICSPCLK and ICSPDAT are dedicated to the debugger)
  [11] LPBOR — Low-Power Brown Out Reset
    1=OFF (Low-Power BOR is disabled); 0=ON (Low-Power BOR is enabled)
  [10] BORV — Brown-out Reset Voltage Selection
    1=LO (Brown-out Reset Voltage (Vbor), 1.9V trip point selected.); 0=HI (Brown-out Reset Voltage (Vbor), 2.7V trip point selected.)
  [9] STVREN — Stack Overflow/Underflow Reset Enable
    1=ON (Stack Overflow or Underflow will cause a Reset); 0=OFF (Stack Overflow or Underflow will not cause a Reset)
  [1:0] WRT — Flash Memory Self-Write Protection
    3=OFF (Write protection off); 2=BOOT (000h to 1FFh write protected, 200h to 1FFFh may be modified by PMCON control); 1=HALF (000h to 0FFFh write protected, 1000h to 1FFFh may be modified by PMCON control); 0=ALL (000h to 1FFFh write protected, no addresses may be modified by PMCON control)
