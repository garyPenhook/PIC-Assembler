# PIC16F1947 register map
Vendor: Microchip
Architecture 16Exxx. Special function registers and configuration words.
Registers are 8-bit, read-write, reset 0x0 unless marked. A register's access mark holds for its fields unless they carry their own. Addresses are absolute, and some are shared; only a register's first bit layout is shown; lines under a group give offsets from that group; [hi:lo] are bit positions; {n}, {i} and the like mark numbered series; 'fields as' and 'values as' point back to an identical list; <NAME> marks a mode.

## Further device data
pins=1: RE1/P2C/VLCD2; 2: RE0/P2D/VLCD1; 3: RG0/CCP3/P3A/SEG42; 4: RG1/AN15/CPS15/TX2/CK2/C3OUT/SEG43; 5: RG2/AN14/CPS14/RX2/DT2/C3IN+/SEG44; 6: RG3/AN13/CPS13/C3IN0-/CCP4/P3D/SEG45; 7: RG5/MCLR/Vpp; 8: RG4/AN12/CPS12/C3IN1-/CCP5/P1D/SEG26; 9: Vss; 10: Vdd; 11: RF7/AN5/CPS5/C3IN3-/C2IN3-/C1IN3-/SS1/SEG25; 12: RF6/AN11/CPS11/C1IN+/SEG24; 13: RF5/AN10/CPS10/C2IN1-/C1IN1-/DACOUT/SEG23; 14: RF4/AN9/CPS9/C2IN+/SEG22; 15: RF3/AN8/CPS8/C3IN2-/C2IN2-/C1IN2-/SEG21; 16: RF2/AN7/CPS7/C1OUT/SRQ/SEG20; 17: RF1/AN6/CPS6/C2OUT/SRNQ/SEG19; 18: RF0/AN16/CPS16/C2IN0-/C1IN0-/SEG41/Vcap; 19: AVdd; 20: AVss; 21: RA3/AN3/Vref+/CPS3/SEG35; 22: RA2/AN2/Vref-/CPS2/SEG34; 23: RA1/AN1/CPS1/SEG18; 24: RA0/AN0/CPS0/SEG33; 25: Vss; 26: Vdd; 27: RA5/AN4/CPS4/SEG15; 28: RA4/T0CKI/SEG14; 29: RC1/T1OSI/P2A/CCP2/SEG32; 30: RC0/T1OSO/T1CKI/SEG40; 31: RC6/TX1/CK1/SEG27; 32: RC7/RX1/DT1/SEG28; 33: RC2/CCP1/P1A/SEG13; 34: RC3/SCK1/SCL1/SEG17; 35: RC4/SDI1/SDA1/SEG16; 36: RC5/SDO1/SEG12; 37: RB7/ICSPDAT/ICDDAT/SEG39; 38: Vdd; 39: RA7/OSC1/CLKIN/SEG37; 40: RA6/OSC2/CLKOUT/SEG36; 41: Vss; 42: RB6/ICSPCLK/ICDCLK/SEG38; 43: RB5/T1G/SEG29; 44: RB4/SEG11; 45: RB3/SEG10; 46: RB2/SEG9; 47: RB1/SEG8; 48: RB0/INT/SRI/FLT0/SEG30; 49: RD7/SS2/SEG7; 50: RD6/SCK2/SCL2/P1B/SEG6; 51: RD5/SDI2/SDA2/P1C/SEG5; 52: RD4/SDO2/P3B/SEG4; 53: RD3/P3C/SEG3; 54: RD2/P2B/SEG2; 55: RD1/P2C/SEG1; 56: Vss; 57: Vdd; 58: RD0/P2D/SEG0; 59: RE7/CCP2/P2A/SEG31; 60: RE6/P1B/COM3; 61: RE5/P1C/COM2; 62: RE4/P3B/COM1; 63: RE3/P3C/COM0; 64: RE2/P2B/VLCD3

## CONFIG — Configuration words, addresses in ProgramSpace
0x8007 CONFIG1 14-bit reset 0x3FFF
  [13] FCMEN — Fail-Safe Clock Monitor Enable
    1=ON (Fail-Safe Clock Monitor is enabled); 0=OFF (Fail-Safe Clock Monitor is disabled)
  [12] IESO — Internal/External Switchover
    1=ON (Internal/External Switchover mode is enabled); 0=OFF (Internal/External Switchover mode is disabled)
  [11] CLKOUTEN — Clock Out Enable
    1=OFF (CLKOUT function is disabled. I/O or oscillator function on the CLKOUT pin); 0=ON (CLKOUT function is enabled on the CLKOUT pin)
  [10:9] BOREN — Brown-out Reset Enable
    3=ON (Brown-out Reset enabled); 2=NSLEEP (Brown-out Reset enabled while running and disabled in Sleep); 1=SBODEN (Brown-out Reset controlled by the SBOREN bit in the BORCON register); 0=OFF (Brown-out Reset disabled)
  [8] CPD — Data Memory Code Protection
    1=OFF (Data memory code protection is disabled); 0=ON (Data memory code protection is enabled)
  [7] CP — Flash Program Memory Code Protection
    1=OFF (Program memory code protection is disabled); 0=ON (Program memory code protection is enabled)
  [6] MCLRE — MCLR Pin Function Select
    1=ON (MCLR/VPP pin function is MCLR); 0=OFF (MCLR/VPP pin function is digital input)
  [5] PWRTE — Power-up Timer Enable
    1=OFF (PWRT disabled); 0=ON (PWRT enabled)
  [4:3] WDTE — Watchdog Timer Enable
    3=ON (WDT enabled); 2=NSLEEP (WDT enabled while running and disabled in Sleep); 1=SWDTEN (WDT controlled by the SWDTEN bit in the WDTCON register); 0=OFF (WDT disabled)
  [2:0] FOSC — Oscillator Selection
    7=ECH (ECH, External Clock, High Power Mode (4-32 MHz): device clock supplied to CLKIN pin); 6=ECM (ECM, External Clock, Medium Power Mode (0.5-4 MHz): device clock supplied to CLKIN pin); 5=ECL (ECL, External Clock, Low Power Mode (0-0.5 MHz): device clock supplied to CLKIN pin); 4=INTOSC (INTOSC oscillator: I/O function on CLKIN pin); 3=EXTRC (EXTRC oscillator: External RC circuit connected to CLKIN pin); 2=HS (HS Oscillator, High-speed crystal/resonator connected between OSC1 and OSC2 pins); 1=XT (XT Oscillator, Crystal/resonator connected between OSC1 and OSC2 pins); 0=LP (LP Oscillator, Low-power crystal connected between OSC1 and OSC2 pins)
0x8008 CONFIG2 14-bit reset 0x3FFF
  [13] LVP — Low-Voltage Programming Enable
    1=ON (Low-voltage programming enabled); 0=OFF (High-voltage on MCLR/VPP must be used for programming)
  [12] DEBUG — In-Circuit Debugger Mode
    1=OFF (In-Circuit Debugger disabled, ICSPCLK and ICSPDAT are general purpose I/O pins); 0=ON (In-Circuit Debugger enabled, ICSPCLK and ICSPDAT are dedicated to the debugger)
  [10] BORV — Brown-out Reset Voltage Selection
    1=LO (Brown-out Reset Voltage (Vbor), low trip point selected.); 0=HI (Brown-out Reset Voltage (Vbor), high trip point selected.)
  [9] STVREN — Stack Overflow/Underflow Reset Enable
    1=ON (Stack Overflow or Underflow will cause a Reset); 0=OFF (Stack Overflow or Underflow will not cause a Reset)
  [8] PLLEN — PLL Enable
    1=ON (4x PLL enabled); 0=OFF (4x PLL disabled)
  [4] VCAPEN — Voltage Regulator Capacitor Enable
    1=OFF (VCAP pin functionality is disabled); 0=ON (VCAP functionality is enabled on VCAP pin)
  [1:0] WRT — Flash Memory Self-Write Protection
    3=OFF (Write protection off); 2=BOOT (000h to 1FFh write protected, 200h to 3FFFh may be modified by EECON control); 1=HALF (000h to 1FFFh write protected, 2000h to 3FFFh may be modified by EECON control); 0=ALL (000h to 3FFFh write protected, no addresses may be modified by EECON control)
