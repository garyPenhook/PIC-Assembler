# PIC16LF1907 register map
Vendor: Microchip
Architecture 16Exxx. Special function registers and configuration words.
Registers are 8-bit, read-write, no defined reset value unless marked. A register's access mark holds for its fields unless they carry their own. Addresses are absolute, and some are shared; only a register's first bit layout is shown; lines under a group give offsets from that group; [hi:lo] are bit positions; {n}, {i} and the like mark numbered series; 'fields as' and 'values as' point back to an identical list; <NAME> marks a mode.

## Further device data
pins=1: RE3/MCLR/Vpp; 2: RA0/AN0/SEG12; 3: RA1/AN1/SEG7; 4: RA2/AN2/COM2; 5: RA3/AN3/Vref+/SEG15; 6: RA4/T0CKI/SEG4; 7: RA5/AN4/SEG5; 8: RE0/AN5/SEG21; 9: RE1/AN6/SEG22; 10: RE2/AN7/SEG23; 11: Vdd; 12: Vss; 13: RA7/CLKI/SEG2; 14: RA6/CLKO/SEG1; 15: RC0/T1OSO/T1CKI; 16: RC1/T1OSI; 17: RC2/SEG3; 18: RC3/SEG6; 19: RD0/COM3; 20: RD1/SEG27; 21: RD2/SEG28; 22: RD3/SEG16; 23: RC4/T1G/SEG11; 24: RC5/SEG10; 25: RC6/TX/CK/SEG9; 26: RC7/RX/DT/SEG8; 27: RD4/SEG17; 28: RD5/SEG18; 29: RD6/SEG19; 30: RD7/SEG20; 31: Vss; 32: Vdd; 33: RB0/AN12/INT/SEG0; 34: RB1/AN10/SEG24/VLCD1; 35: RB2/AN8/SEG25/VLCD2; 36: RB3/AN9/SEG26/VLCD3; 37: RB4/AN11/COM0; 38: RB5/AN13/COM1; 39: RB6/ICSPCLK/ICDCLK/SEG14; 40: RB7/ICSPDAT/ICDDAT/SEG13

## CONFIG — Configuration words, addresses in ProgramSpace
0x8007 CONFIG1 14-bit reset 0x3FFF
  [11] CLKOUTEN — Clock Out Enable
    1=OFF (CLKOUT function is disabled. I/O or oscillator function on the CLKOUT pin); 0=ON (CLKOUT function is enabled on the CLKOUT pin)
  [10:9] BOREN — Brown-out Reset Enable
    3=ON (Brown-out Reset enabled); 2=NSLEEP (Brown-out Reset enabled while running and disabled in Sleep); 1=SBODEN (Brown-out Reset controlled by the SBOREN bit in the BORCON register); 0=OFF (Brown-out Reset disabled)
  [7] CP — Flash Program Memory Code Protection
    1=OFF (Program memory code protection is disabled); 0=ON (Program memory code protection is enabled)
  [6] MCLRE — MCLR Pin Function Select
    1=ON (MCLR/VPP pin function is MCLR); 0=OFF (MCLR/VPP pin function is digital input)
  [5] PWRTE — Power-up Timer Enable
    1=OFF (PWRT disabled); 0=ON (PWRT enabled)
  [4:3] WDTE — Watchdog Timer Enable
    3=ON (WDT enabled); 2=NSLEEP (WDT enabled while running and disabled in Sleep); 1=SWDTEN (WDT controlled by the SWDTEN bit in the WDTCON register); 0=OFF (WDT disabled)
  [1:0] FOSC — Oscillator Selection
    3=ECH (ECH, External Clock, High Power Mode (4-20 MHz): device clock supplied to CLKIN pin); 2=ECM (ECM, External Clock, Medium Power Mode (0.5-4 MHz): device clock supplied to CLKIN pin); 1=ECL (ECL, External Clock, Low Power Mode (0-0.5 MHz): device clock supplied to CLKIN pin); 0=INTOSC (INTOSC oscillator: I/O function on CLKIN pin)
0x8008 CONFIG2 14-bit reset 0x3FFF
  [13] LVP — Low-Voltage Programming Enable
    1=ON (Low-voltage programming enabled); 0=OFF (High-voltage on MCLR/VPP must be used for programming)
  [12] DEBUG — In-Circuit Debugger Mode
    1=OFF (In-Circuit Debugger disabled, ICSPCLK and ICSPDAT are general purpose I/O pins); 0=ON (In-Circuit Debugger enabled, ICSPCLK and ICSPDAT are dedicated to the debugger)
  [11] LPBOR — Low-Power Brown-out Reset
    1=OFF (Low-Power BOR is disabled); 0=ON (Low-Power BOR is enabled)
  [10] BORV — Brown-out Reset Voltage Selection
    1=LO (Brown-out Reset Voltage (Vbor), low trip point selected.); 0=HI (Brown-out Reset Voltage (Vbor), high trip point selected.)
  [9] STVREN — Stack Overflow/Underflow Reset Enable
    1=ON (Stack Overflow or Underflow will cause a Reset); 0=OFF (Stack Overflow or Underflow will not cause a Reset)
  [1:0] WRT — Flash Memory Self-Write Protection
    3=OFF (Write protection off); 2=BOOT (000h to 1FFh write protected, 200h to 1FFFh may be modified by PMCON control); 1=HALF (000h to FFFh write protected, 1000h to 1FFFh may be modified by PMCON control); 0=ALL (000h to 1FFFh write protected, no addresses may be modified by PMCON control)
