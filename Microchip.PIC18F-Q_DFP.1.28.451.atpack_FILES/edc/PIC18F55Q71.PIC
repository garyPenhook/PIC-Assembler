# PIC18F55Q71 register map
Vendor: Microchip
Architecture 18xxxx. Special function registers and configuration words.
Registers are 8-bit, read-write, reset 0x0 unless marked. A register's access mark holds for its fields unless they carry their own. Addresses are absolute, and some are shared; only a register's first bit layout is shown; lines under a group give offsets from that group; [hi:lo] are bit positions; {n}, {i} and the like mark numbered series; 'fields as' and 'values as' point back to an identical list; <NAME> marks a mode.

## Further device data
pins=1: ANC7/IOCC7/RC7/ANPC7; 2: AND4/RD4/ANPD4; 3: AND5/RD5/ANPD5/ANND5; 4: AND6/RD6/ANPD6; 5: AND7/RD7/ANPD7/ANND7; 6: AVSS/VSS; 7: AVDD/VDD; 8: VREF+/ZCD/ANB0/C2IN1+/IOCB0/RB0/ANPB0/ANNB0; 9: OPA2OUT/OPA1IN3-/OPA1IN3+/ANB1/C1IN3-/C2IN3-/SMB_I2C/IOCB1/RB1/ANPB1; 10: OPA2IN3-/OPA2IN3+/ANB2/SMB_I2C/IOCB2/RB2/ANPB2/ANNB2; 11: OPA2IN2-/OPA2IN2+/ANB3/C1IN2-/C2IN2-/IOCB3/RB3/ANPB3; 12: ANF4/RF4/ANPF4/ANNF4; 13: ANF5/RF5/ANPF5; 14: ANF6/RF6/ANPF6/ANNF6; 15: ANF7/RF7/ANPF7; 16: OPA2IN0-/OPA2IN0+/ANB4/IOCB4/RB4/ANPB4/ANNB4; 17: VREF-/ANB5/IOCB5/RB5/ANPB5; 18: ICSPCLK/ICDCLK/ANB6/IOCB6/RB6/ANPB6/ANNB6; 19: ICSPDAT/ICDDAT/DAC1OUT2/DAC2OUT2/DAC3OUT2/ANB7/IOCB7/RB7/ANPB7; 20: VPP/MCLR_n/ICDMCLR_n/IOCE3/RE3; 21: ANA0/C1IN0-/C2IN0-/IOCA0/RA0/ANPA0; 22: OPA1OUT/OPA2IN1-/OPA2IN1+/ANA1/C1IN1-/C2IN1-/IOCA1/RA1/ANPA1/ANNA1; 23: DAC1OUT1/DAC2OUT1/DAC3OUT1/VREF-/OPA1IN0-/OPA1IN0+/ANA2/C1IN0+/C2IN0+/IOCA2/RA2/ANPA2; 24: VREF+/ANA3/C1IN1+/IOCA3/RA3/ANPA3/ANNA3; 25: OPA1IN1-/OPA1IN1+/ANA4/IOCA4/RA4/ANPA4; 26: OPA1IN2-/OPA1IN2+/ANA5/IOCA5/RA5/ANPA5/ANNA5; 27: ANE0/RE0/ANPE0; 28: ANE1/RE1/ANPE1/ANNE1; 29: ANE2/RE2/ANPE2; 30: AVDD/VDD; 31: AVSS/VSS; 32: CLKIN/OSC1/ANA7/IOCA7/RA7/ANPA7/ANNA7; 33: OSC2/CLKOUT/ANA6/IOCA6/RA6/ANPA6/ANNA6; 34: SOSCO/ANC0/IOCC0/RC0/ANPC0; 35: SOSCI/ANC1/IOCC1/RC1/ANPC1/ANNC1; 36: ANF0/RF0/ANPF0; 37: ANF1/RF1/ANPF1/ANNF1; 38: ANF2/RF2/ANPF2; 39: ANF3/RF3/ANPF3/ANNF3; 40: VREF+/ANC2/IOCC2/RC2/ANPC2; 41: SMB_I2C/ANC3/IOCC3/RC3/ANPC3/ANNC3; 42: AND0/RD0/ANPD0; 43: AND1/RD1/ANPD1; 44: AND2/RD2/ANPD2/ANND2; 45: AND3/RD3/ANPD3/ANND3; 46: SMB_I2C/ANC4/IOCC4/RC4/ANPC4; 47: VREF-/ANC5/IOCC5/RC5/ANPC5; 48: ANC6/IOCC6/RC6/ANPC6/ANNC6, interrupts=0 SWINT — Software Interrupt; 1 HLVD — HLVD Interrupt; 2 OSF — Oscillator Failure Interrupt; 3 CSW — Clock Switch Interrupt; 4 NVM — NVM Interrupt; 5 CLC1 — CLC1 Interrupt; 6 CRC — CRC Interrupt; 7 IOC — Interrupt on change; 8 INT0 — External Interrupt 0; 9 ADCH1 — ADC Threshold Interrupt-Context 0; 10 AD — ADC Interrupt; 11 ACT — Active Clock Tuning Interrupt; 12 CMP1 — Comparator 1 Interrupt; 13 ADCH2 — ADC Threshold Interrupt-Context 1; 14 ADCH3 — ADC Threshold Interrupt-Context 2; 15 ADCH4 — ADC Threshold Interrupt-Context 3; 16 ZCD — ZCD Interrupt; 17 CLC5 — CLC5 Interrupt; 18 IOCSR — Signal Routing Port Interrupt on Change; 20 DMA1SCNT — DMA1 Source count Interrupt; 21 DMA1DCNT — DMA1 Destination count Interrupt; 22 DMA1OR — DMA1 Overflow Interrupt; 23 DMA1A — DMA1 Abort Interrupt; 24 SPI1RX — SPI1 Receive Interrupt; 25 SPI1TX — SPI1 Transmit Interrupt; 26 SPI1 — SPI1 Interrupt; 27 TMR2 — Timer2 Interrupt; 28 TMR1 — Timer1 Interrupt; 29 TMR1G — Timer1 Gate Interrupt; 30 CCP1 — CCP1 Interrupt; 31 TMR0 — Timer0 Interrupt; 32 U1RX — UART1 Receive Interrupt; 33 U1TX — UART1 Transmit Interrupt; 34 U1E — UART1 Error Interrupt; 35 U1 — UART1 Interrupt; 36 TMR3 — Timer3 Interrupt; 37 TMR3G — Timer3 Gate Interrupt; 38 PWM1PR — PWM1 Period Interrupt; 39 PWM1 — PWM1 Interrupt; 41 CLC6 — CLC5 Interrupt; 44 CMP2 — Comparator 2 Interrupt; 42 TU16A — Universal Timer 16A Interrupt; 45 CLC2 — CLC2 Interrupt; 46 PWM2PR — PWM2 Period Interrupt; 47 PWM2 — PWM2 Interrupt; 48 INT1 — External Interrupt 1; 49 CLC7 — CLC7 Interrupt; 50 CWG1 — CWG1 Interrupt; 51 NCO1 — NCO1 Interrupt; 52 DMA2SCNT — DMA2 Source count Interrupt; 53 DMA2DCNT — DMA2 Destination count Interrupt; 54 DMA2OR — DMA2 Overflow Interrupt; 55 DMA2A — DMA2 Abort Interrupt; 56 I2C1RX — I2C1 Receive Interrupt; 57 I2C1TX — I2C1 Transmit Interrupt; 58 I2C1 — I2C1 Interrupt; 59 I2C1E — I2C1 Error Interrupt; 61 CLC3 — CLC3 Interrupt; 62 PWM3PR — PWM3 Period Interrupt; 63 PWM3 — PWM3 Interrupt; 64 U2RX — UART2 Receive Interrupt; 65 U2TX — UART2 Transmit Interrupt; 66 U2E — UART2 Error Interrupt; 67 U2 — UART2 Interrupt; 69 CLC4 — CLC4 Interrupt; 71 SCAN — Scanner Interrupt; 76 DMA3SCNT — DMA3 Source count Interrupt; 77 DMA3DCNT — DMA3 Destination count Interrupt; 78 DMA3OR — DMA3 Overflow Interrupt; 79 DMA3A — DMA3 Abort Interrupt; 80 INT2 — External Interrupt 2; 81 CLC8 — CLC8 Interrupt; 82 TU16B — Universal Timer 16B Interrupt; 83 TMR4 — Timer4 Interrupt; 84 DMA4SCNT — DMA4 Source count Interrupt; 85 DMA4DCNT — DMA4 Destination count Interrupt; 86 DMA4OR — DMA4 Overflow Interrupt; 87 DMA4A — DMA4 Abort Interrupt; 70 CCP2 — CCP2 Interrupt
