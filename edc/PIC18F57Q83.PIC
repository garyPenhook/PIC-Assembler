# PIC18F57Q83 register map
Vendor: Microchip
Registers are 8-bit, read-write, reset 0x0 unless marked. A register's access mark holds for its fields unless they carry their own. Addresses are absolute, and some are shared; only a register's first bit layout is shown; [hi:lo] are bit positions; {n}, {i} and the like mark numbered series.

## CONFIG (part 3 of 3) — Configuration words, addresses in ProgramSpace
0x30001A CONFIG27 reset 0xFF — Non-Boot Sector Polynomial for CRC on boot bits 7-0
  [7:0] CRCPOLL
    {v}=h{v:02} (Bits 7:0 of CRCPOL are {0x0+v}) (v=0..9); 10=h0A (Bits 7:0 of CRCPOL are 0x0A); 11=h0B (Bits 7:0 of CRCPOL are 0x0B); 12=h0C (Bits 7:0 of CRCPOL are 0x0C); 13=h0D (Bits 7:0 of CRCPOL are 0x0D); 14=h0E (Bits 7:0 of CRCPOL are 0x0E); 15=h0F (Bits 7:0 of CRCPOL are 0x0F); {v}=h{v-6} (Bits 7:0 of CRCPOL are {0x0+v}) (v=16..25); 26=h1A (Bits 7:0 of CRCPOL are 0x1A); 27=h1B (Bits 7:0 of CRCPOL are 0x1B); 28=h1C (Bits 7:0 of CRCPOL are 0x1C); 29=h1D (Bits 7:0 of CRCPOL are 0x1D); 30=h1E (Bits 7:0 of CRCPOL are 0x1E); 31=h1F (Bits 7:0 of CRCPOL are 0x1F); {v}=h{v-12} (Bits 7:0 of CRCPOL are {0x0+v}) (v=32..41); 42=h2A (Bits 7:0 of CRCPOL are 0x2A); 43=h2B (Bits 7:0 of CRCPOL are 0x2B); 44=h2C (Bits 7:0 of CRCPOL are 0x2C); 45=h2D (Bits 7:0 of CRCPOL are 0x2D); 46=h2E (Bits 7:0 of CRCPOL are 0x2E); 47=h2F (Bits 7:0 of CRCPOL are 0x2F); {v}=h{v-18} (Bits 7:0 of CRCPOL are {0x0+v}) (v=48..57); 58=h3A (Bits 7:0 of CRCPOL are 0x3A); 59=h3B (Bits 7:0 of CRCPOL are 0x3B); 60=h3C (Bits 7:0 of CRCPOL are 0x3C); 61=h3D (Bits 7:0 of CRCPOL are 0x3D); 62=h3E (Bits 7:0 of CRCPOL are 0x3E); 63=h3F (Bits 7:0 of CRCPOL are 0x3F); {v}=h{v-24} (Bits 7:0 of CRCPOL are {0x0+v}) (v=64..73); 74=h4A (Bits 7:0 of CRCPOL are 0x4A); 75=h4B (Bits 7:0 of CRCPOL are 0x4B); 76=h4C (Bits 7:0 of CRCPOL are 0x4C); 77=h4D (Bits 7:0 of CRCPOL are 0x4D); 78=h4E (Bits 7:0 of CRCPOL are 0x4E); 79=h4F (Bits 7:0 of CRCPOL are 0x4F); {v}=h{v-30} (Bits 7:0 of CRCPOL are {0x0+v}) (v=80..89); 90=h5A (Bits 7:0 of CRCPOL are 0x5A); 91=h5B (Bits 7:0 of CRCPOL are 0x5B); 92=h5C (Bits 7:0 of CRCPOL are 0x5C); 93=h5D (Bits 7:0 of CRCPOL are 0x5D); 94=h5E (Bits 7:0 of CRCPOL are 0x5E); 95=h5F (Bits 7:0 of CRCPOL are 0x5F); {v}=h{v-36} (Bits 7:0 of CRCPOL are {0x0+v}) (v=96..105); 106=h6A (Bits 7:0 of CRCPOL are 0x6A); 107=h6B (Bits 7:0 of CRCPOL are 0x6B); 108=h6C (Bits 7:0 of CRCPOL are 0x6C); 109=h6D (Bits 7:0 of CRCPOL are 0x6D); 110=h6E (Bits 7:0 of CRCPOL are 0x6E); 111=h6F (Bits 7:0 of CRCPOL are 0x6F); {v}=h{v-42} (Bits 7:0 of CRCPOL are {0x0+v}) (v=112..121); 122=h7A (Bits 7:0 of CRCPOL are 0x7A); 123=h7B (Bits 7:0 of CRCPOL are 0x7B); 124=h7C (Bits 7:0 of CRCPOL are 0x7C); 125=h7D (Bits 7:0 of CRCPOL are 0x7D); 126=h7E (Bits 7:0 of CRCPOL are 0x7E); 127=h7F (Bits 7:0 of CRCPOL are 0x7F); {v}=h{v-48} (Bits 7:0 of CRCPOL are {0x0+v}) (v=128..137); 138=h8A (Bits 7:0 of CRCPOL are 0x8A); 139=h8B (Bits 7:0 of CRCPOL are 0x8B); 140=h8C (Bits 7:0 of CRCPOL are 0x8C); 141=h8D (Bits 7:0 of CRCPOL are 0x8D); 142=h8E (Bits 7:0 of CRCPOL are 0x8E); 143=h8F (Bits 7:0 of CRCPOL are 0x8F); {v}=h{v-54} (Bits 7:0 of CRCPOL are {0x0+v}) (v=144..153); 154=h9A (Bits 7:0 of CRCPOL are 0x9A); 155=h9B (Bits 7:0 of CRCPOL are 0x9B); 156=h9C (Bits 7:0 of CRCPOL are 0x9C); 157=h9D (Bits 7:0 of CRCPOL are 0x9D); 158=h9E (Bits 7:0 of CRCPOL are 0x9E); 159=h9F (Bits 7:0 of CRCPOL are 0x9F); {v}=hA{v-160} (Bits 7:0 of CRCPOL are {0x0+v}) (v=160..169); 170=hAA (Bits 7:0 of CRCPOL are 0xAA); 171=hAB (Bits 7:0 of CRCPOL are 0xAB); 172=hAC (Bits 7:0 of CRCPOL are 0xAC); 173=hAD (Bits 7:0 of CRCPOL are 0xAD); 174=hAE (Bits 7:0 of CRCPOL are 0xAE); 175=hAF (Bits 7:0 of CRCPOL are 0xAF); {v}=hB{v-176} (Bits 7:0 of CRCPOL are {0x0+v}) (v=176..185); 186=hBA (Bits 7:0 of CRCPOL are 0xBA); 187=hBB (Bits 7:0 of CRCPOL are 0xBB); 188=hBC (Bits 7:0 of CRCPOL are 0xBC); 189=hBD (Bits 7:0 of CRCPOL are 0xBD); 190=hBE (Bits 7:0 of CRCPOL are 0xBE); 191=hBF (Bits 7:0 of CRCPOL are 0xBF); {v}=hC{v-192} (Bits 7:0 of CRCPOL are {0x0+v}) (v=192..201); 202=hCA (Bits 7:0 of CRCPOL are 0xCA); 203=hCB (Bits 7:0 of CRCPOL are 0xCB); 204=hCC (Bits 7:0 of CRCPOL are 0xCC); 205=hCD (Bits 7:0 of CRCPOL are 0xCD); 206=hCE (Bits 7:0 of CRCPOL are 0xCE); 207=hCF (Bits 7:0 of CRCPOL are 0xCF); {v}=hD{v-208} (Bits 7:0 of CRCPOL are {0x0+v}) (v=208..217); 218=hDA (Bits 7:0 of CRCPOL are 0xDA); 219=hDB (Bits 7:0 of CRCPOL are 0xDB); 220=hDC (Bits 7:0 of CRCPOL are 0xDC); 221=hDD (Bits 7:0 of CRCPOL are 0xDD); 222=hDE (Bits 7:0 of CRCPOL are 0xDE); 223=hDF (Bits 7:0 of CRCPOL are 0xDF); {v}=hE{v-224} (Bits 7:0 of CRCPOL are {0x0+v}) (v=224..233); 234=hEA (Bits 7:0 of CRCPOL are 0xEA); 235=hEB (Bits 7:0 of CRCPOL are 0xEB); 236=hEC (Bits 7:0 of CRCPOL are 0xEC); 237=hED (Bits 7:0 of CRCPOL are 0xED); 238=hEE (Bits 7:0 of CRCPOL are 0xEE); 239=hEF (Bits 7:0 of CRCPOL are 0xEF); {v}=hF{v-240} (Bits 7:0 of CRCPOL are {0x0+v}) (v=240..249); 250=hFA (Bits 7:0 of CRCPOL are 0xFA); 251=hFB (Bits 7:0 of CRCPOL are 0xFB); 252=hFC (Bits 7:0 of CRCPOL are 0xFC); 253=hFD (Bits 7:0 of CRCPOL are 0xFD); 254=hFE (Bits 7:0 of CRCPOL are 0xFE); 255=hFF (Bits 7:0 of CRCPOL are 0xFF)
0x30001B CONFIG28 reset 0xFF — Non-Boot Sector Seed for CRC on boot bits 31-24
  [7:0] CRCSEEDT
    {v}=h{v:02} (Bits 31:24 of CRCSEED are {0x0+v}) (v=0..9); 10=h0A (Bits 31:24 of CRCSEED are 0x0A); 11=h0B (Bits 31:24 of CRCSEED are 0x0B); 12=h0C (Bits 31:24 of CRCSEED are 0x0C); 13=h0D (Bits 31:24 of CRCSEED are 0x0D); 14=h0E (Bits 31:24 of CRCSEED are 0x0E); 15=h0F (Bits 31:24 of CRCSEED are 0x0F); {v}=h{v-6} (Bits 31:24 of CRCSEED are {0x0+v}) (v=16..25); 26=h1A (Bits 31:24 of CRCSEED are 0x1A); 27=h1B (Bits 31:24 of CRCSEED are 0x1B); 28=h1C (Bits 31:24 of CRCSEED are 0x1C); 29=h1D (Bits 31:24 of CRCSEED are 0x1D); 30=h1E (Bits 31:24 of CRCSEED are 0x1E); 31=h1F (Bits 31:24 of CRCSEED are 0x1F); {v}=h{v-12} (Bits 31:24 of CRCSEED are {0x0+v}) (v=32..41); 42=h2A (Bits 31:24 of CRCSEED are 0x2A); 43=h2B (Bits 31:24 of CRCSEED are 0x2B); 44=h2C (Bits 31:24 of CRCSEED are 0x2C); 45=h2D (Bits 31:24 of CRCSEED are 0x2D); 46=h2E (Bits 31:24 of CRCSEED are 0x2E); 47=h2F (Bits 31:24 of CRCSEED are 0x2F); {v}=h{v-18} (Bits 31:24 of CRCSEED are {0x0+v}) (v=48..57); 58=h3A (Bits 31:24 of CRCSEED are 0x3A); 59=h3B (Bits 31:24 of CRCSEED are 0x3B); 60=h3C (Bits 31:24 of CRCSEED are 0x3C); 61=h3D (Bits 31:24 of CRCSEED are 0x3D); 62=h3E (Bits 31:24 of CRCSEED are 0x3E); 63=h3F (Bits 31:24 of CRCSEED are 0x3F); {v}=h{v-24} (Bits 31:24 of CRCSEED are {0x0+v}) (v=64..73); 74=h4A (Bits 31:24 of CRCSEED are 0x4A); 75=h4B (Bits 31:24 of CRCSEED are 0x4B); 76=h4C (Bits 31:24 of CRCSEED are 0x4C); 77=h4D (Bits 31:24 of CRCSEED are 0x4D); 78=h4E (Bits 31:24 of CRCSEED are 0x4E); 79=h4F (Bits 31:24 of CRCSEED are 0x4F); {v}=h{v-30} (Bits 31:24 of CRCSEED are {0x0+v}) (v=80..89); 90=h5A (Bits 31:24 of CRCSEED are 0x5A); 91=h5B (Bits 31:24 of CRCSEED are 0x5B); 92=h5C (Bits 31:24 of CRCSEED are 0x5C); 93=h5D (Bits 31:24 of CRCSEED are 0x5D); 94=h5E (Bits 31:24 of CRCSEED are 0x5E); 95=h5F (Bits 31:24 of CRCSEED are 0x5F); {v}=h{v-36} (Bits 31:24 of CRCSEED are {0x0+v}) (v=96..105); 106=h6A (Bits 31:24 of CRCSEED are 0x6A); 107=h6B (Bits 31:24 of CRCSEED are 0x6B); 108=h6C (Bits 31:24 of CRCSEED are 0x6C); 109=h6D (Bits 31:24 of CRCSEED are 0x6D); 110=h6E (Bits 31:24 of CRCSEED are 0x6E); 111=h6F (Bits 31:24 of CRCSEED are 0x6F); {v}=h{v-42} (Bits 31:24 of CRCSEED are {0x0+v}) (v=112..121); 122=h7A (Bits 31:24 of CRCSEED are 0x7A); 123=h7B (Bits 31:24 of CRCSEED are 0x7B); 124=h7C (Bits 31:24 of CRCSEED are 0x7C); 125=h7D (Bits 31:24 of CRCSEED are 0x7D); 126=h7E (Bits 31:24 of CRCSEED are 0x7E); 127=h7F (Bits 31:24 of CRCSEED are 0x7F); {v}=h{v-48} (Bits 31:24 of CRCSEED are {0x0+v}) (v=128..137); 138=h8A (Bits 31:24 of CRCSEED are 0x8A); 139=h8B (Bits 31:24 of CRCSEED are 0x8B); 140=h8C (Bits 31:24 of CRCSEED are 0x8C); 141=h8D (Bits 31:24 of CRCSEED are 0x8D); 142=h8E (Bits 31:24 of CRCSEED are 0x8E); 143=h8F (Bits 31:24 of CRCSEED are 0x8F); {v}=h{v-54} (Bits 31:24 of CRCSEED are {0x0+v}) (v=144..153); 154=h9A (Bits 31:24 of CRCSEED are 0x9A); 155=h9B (Bits 31:24 of CRCSEED are 0x9B); 156=h9C (Bits 31:24 of CRCSEED are 0x9C); 157=h9D (Bits 31:24 of CRCSEED are 0x9D); 158=h9E (Bits 31:24 of CRCSEED are 0x9E); 159=h9F (Bits 31:24 of CRCSEED are 0x9F); {v}=hA{v-160} (Bits 31:24 of CRCSEED are {0x0+v}) (v=160..169); 170=hAA (Bits 31:24 of CRCSEED are 0xAA); 171=hAB (Bits 31:24 of CRCSEED are 0xAB); 172=hAC (Bits 31:24 of CRCSEED are 0xAC); 173=hAD (Bits 31:24 of CRCSEED are 0xAD); 174=hAE (Bits 31:24 of CRCSEED are 0xAE); 175=hAF (Bits 31:24 of CRCSEED are 0xAF); {v}=hB{v-176} (Bits 31:24 of CRCSEED are {0x0+v}) (v=176..185); 186=hBA (Bits 31:24 of CRCSEED are 0xBA); 187=hBB (Bits 31:24 of CRCSEED are 0xBB); 188=hBC (Bits 31:24 of CRCSEED are 0xBC); 189=hBD (Bits 31:24 of CRCSEED are 0xBD); 190=hBE (Bits 31:24 of CRCSEED are 0xBE); 191=hBF (Bits 31:24 of CRCSEED are 0xBF); {v}=hC{v-192} (Bits 31:24 of CRCSEED are {0x0+v}) (v=192..201); 202=hCA (Bits 31:24 of CRCSEED are 0xCA); 203=hCB (Bits 31:24 of CRCSEED are 0xCB); 204=hCC (Bits 31:24 of CRCSEED are 0xCC); 205=hCD (Bits 31:24 of CRCSEED are 0xCD); 206=hCE (Bits 31:24 of CRCSEED are 0xCE); 207=hCF (Bits 31:24 of CRCSEED are 0xCF); {v}=hD{v-208} (Bits 31:24 of CRCSEED are {0x0+v}) (v=208..217); 218=hDA (Bits 31:24 of CRCSEED are 0xDA); 219=hDB (Bits 31:24 of CRCSEED are 0xDB); 220=hDC (Bits 31:24 of CRCSEED are 0xDC); 221=hDD (Bits 31:24 of CRCSEED are 0xDD); 222=hDE (Bits 31:24 of CRCSEED are 0xDE); 223=hDF (Bits 31:24 of CRCSEED are 0xDF); {v}=hE{v-224} (Bits 31:24 of CRCSEED are {0x0+v}) (v=224..233); 234=hEA (Bits 31:24 of CRCSEED are 0xEA); 235=hEB (Bits 31:24 of CRCSEED are 0xEB); 236=hEC (Bits 31:24 of CRCSEED are 0xEC); 237=hED (Bits 31:24 of CRCSEED are 0xED); 238=hEE (Bits 31:24 of CRCSEED are 0xEE); 239=hEF (Bits 31:24 of CRCSEED are 0xEF); {v}=hF{v-240} (Bits 31:24 of CRCSEED are {0x0+v}) (v=240..249); 250=hFA (Bits 31:24 of CRCSEED are 0xFA); 251=hFB (Bits 31:24 of CRCSEED are 0xFB); 252=hFC (Bits 31:24 of CRCSEED are 0xFC); 253=hFD (Bits 31:24 of CRCSEED are 0xFD); 254=hFE (Bits 31:24 of CRCSEED are 0xFE); 255=hFF (Bits 31:24 of CRCSEED are 0xFF)
0x30001C CONFIG29 reset 0xFF — Non-Boot Sector Seed for CRC on boot bits 23-16
  [7:0] CRCSEEDU
    {v}=h{v:02} (Bits 23:16 of CRCSEED are {0x0+v}) (v=0..9); 10=h0A (Bits 23:16 of CRCSEED are 0x0A); 11=h0B (Bits 23:16 of CRCSEED are 0x0B); 12=h0C (Bits 23:16 of CRCSEED are 0x0C); 13=h0D (Bits 23:16 of CRCSEED are 0x0D); 14=h0E (Bits 23:16 of CRCSEED are 0x0E); 15=h0F (Bits 23:16 of CRCSEED are 0x0F); {v}=h{v-6} (Bits 23:16 of CRCSEED are {0x0+v}) (v=16..25); 26=h1A (Bits 23:16 of CRCSEED are 0x1A); 27=h1B (Bits 23:16 of CRCSEED are 0x1B); 28=h1C (Bits 23:16 of CRCSEED are 0x1C); 29=h1D (Bits 23:16 of CRCSEED are 0x1D); 30=h1E (Bits 23:16 of CRCSEED are 0x1E); 31=h1F (Bits 23:16 of CRCSEED are 0x1F); {v}=h{v-12} (Bits 23:16 of CRCSEED are {0x0+v}) (v=32..41); 42=h2A (Bits 23:16 of CRCSEED are 0x2A); 43=h2B (Bits 23:16 of CRCSEED are 0x2B); 44=h2C (Bits 23:16 of CRCSEED are 0x2C); 45=h2D (Bits 23:16 of CRCSEED are 0x2D); 46=h2E (Bits 23:16 of CRCSEED are 0x2E); 47=h2F (Bits 23:16 of CRCSEED are 0x2F); {v}=h{v-18} (Bits 23:16 of CRCSEED are {0x0+v}) (v=48..57); 58=h3A (Bits 23:16 of CRCSEED are 0x3A); 59=h3B (Bits 23:16 of CRCSEED are 0x3B); 60=h3C (Bits 23:16 of CRCSEED are 0x3C); 61=h3D (Bits 23:16 of CRCSEED are 0x3D); 62=h3E (Bits 23:16 of CRCSEED are 0x3E); 63=h3F (Bits 23:16 of CRCSEED are 0x3F); {v}=h{v-24} (Bits 23:16 of CRCSEED are {0x0+v}) (v=64..73); 74=h4A (Bits 23:16 of CRCSEED are 0x4A); 75=h4B (Bits 23:16 of CRCSEED are 0x4B); 76=h4C (Bits 23:16 of CRCSEED are 0x4C); 77=h4D (Bits 23:16 of CRCSEED are 0x4D); 78=h4E (Bits 23:16 of CRCSEED are 0x4E); 79=h4F (Bits 23:16 of CRCSEED are 0x4F); {v}=h{v-30} (Bits 23:16 of CRCSEED are {0x0+v}) (v=80..89); 90=h5A (Bits 23:16 of CRCSEED are 0x5A); 91=h5B (Bits 23:16 of CRCSEED are 0x5B); 92=h5C (Bits 23:16 of CRCSEED are 0x5C); 93=h5D (Bits 23:16 of CRCSEED are 0x5D); 94=h5E (Bits 23:16 of CRCSEED are 0x5E); 95=h5F (Bits 23:16 of CRCSEED are 0x5F); {v}=h{v-36} (Bits 23:16 of CRCSEED are {0x0+v}) (v=96..105); 106=h6A (Bits 23:16 of CRCSEED are 0x6A); 107=h6B (Bits 23:16 of CRCSEED are 0x6B); 108=h6C (Bits 23:16 of CRCSEED are 0x6C); 109=h6D (Bits 23:16 of CRCSEED are 0x6D); 110=h6E (Bits 23:16 of CRCSEED are 0x6E); 111=h6F (Bits 23:16 of CRCSEED are 0x6F); {v}=h{v-42} (Bits 23:16 of CRCSEED are {0x0+v}) (v=112..121); 122=h7A (Bits 23:16 of CRCSEED are 0x7A); 123=h7B (Bits 23:16 of CRCSEED are 0x7B); 124=h7C (Bits 23:16 of CRCSEED are 0x7C); 125=h7D (Bits 23:16 of CRCSEED are 0x7D); 126=h7E (Bits 23:16 of CRCSEED are 0x7E); 127=h7F (Bits 23:16 of CRCSEED are 0x7F); {v}=h{v-48} (Bits 23:16 of CRCSEED are {0x0+v}) (v=128..137); 138=h8A (Bits 23:16 of CRCSEED are 0x8A); 139=h8B (Bits 23:16 of CRCSEED are 0x8B); 140=h8C (Bits 23:16 of CRCSEED are 0x8C); 141=h8D (Bits 23:16 of CRCSEED are 0x8D); 142=h8E (Bits 23:16 of CRCSEED are 0x8E); 143=h8F (Bits 23:16 of CRCSEED are 0x8F); {v}=h{v-54} (Bits 23:16 of CRCSEED are {0x0+v}) (v=144..153); 154=h9A (Bits 23:16 of CRCSEED are 0x9A); 155=h9B (Bits 23:16 of CRCSEED are 0x9B); 156=h9C (Bits 23:16 of CRCSEED are 0x9C); 157=h9D (Bits 23:16 of CRCSEED are 0x9D); 158=h9E (Bits 23:16 of CRCSEED are 0x9E); 159=h9F (Bits 23:16 of CRCSEED are 0x9F); {v}=hA{v-160} (Bits 23:16 of CRCSEED are {0x0+v}) (v=160..169); 170=hAA (Bits 23:16 of CRCSEED are 0xAA); 171=hAB (Bits 23:16 of CRCSEED are 0xAB); 172=hAC (Bits 23:16 of CRCSEED are 0xAC); 173=hAD (Bits 23:16 of CRCSEED are 0xAD); 174=hAE (Bits 23:16 of CRCSEED are 0xAE); 175=hAF (Bits 23:16 of CRCSEED are 0xAF); {v}=hB{v-176} (Bits 23:16 of CRCSEED are {0x0+v}) (v=176..185); 186=hBA (Bits 23:16 of CRCSEED are 0xBA); 187=hBB (Bits 23:16 of CRCSEED are 0xBB); 188=hBC (Bits 23:16 of CRCSEED are 0xBC); 189=hBD (Bits 23:16 of CRCSEED are 0xBD); 190=hBE (Bits 23:16 of CRCSEED are 0xBE); 191=hBF (Bits 23:16 of CRCSEED are 0xBF); {v}=hC{v-192} (Bits 23:16 of CRCSEED are {0x0+v}) (v=192..201); 202=hCA (Bits 23:16 of CRCSEED are 0xCA); 203=hCB (Bits 23:16 of CRCSEED are 0xCB); 204=hCC (Bits 23:16 of CRCSEED are 0xCC); 205=hCD (Bits 23:16 of CRCSEED are 0xCD); 206=hCE (Bits 23:16 of CRCSEED are 0xCE); 207=hCF (Bits 23:16 of CRCSEED are 0xCF); {v}=hD{v-208} (Bits 23:16 of CRCSEED are {0x0+v}) (v=208..217); 218=hDA (Bits 23:16 of CRCSEED are 0xDA); 219=hDB (Bits 23:16 of CRCSEED are 0xDB); 220=hDC (Bits 23:16 of CRCSEED are 0xDC); 221=hDD (Bits 23:16 of CRCSEED are 0xDD); 222=hDE (Bits 23:16 of CRCSEED are 0xDE); 223=hDF (Bits 23:16 of CRCSEED are 0xDF); {v}=hE{v-224} (Bits 23:16 of CRCSEED are {0x0+v}) (v=224..233); 234=hEA (Bits 23:16 of CRCSEED are 0xEA); 235=hEB (Bits 23:16 of CRCSEED are 0xEB); 236=hEC (Bits 23:16 of CRCSEED are 0xEC); 237=hED (Bits 23:16 of CRCSEED are 0xED); 238=hEE (Bits 23:16 of CRCSEED are 0xEE); 239=hEF (Bits 23:16 of CRCSEED are 0xEF); {v}=hF{v-240} (Bits 23:16 of CRCSEED are {0x0+v}) (v=240..249); 250=hFA (Bits 23:16 of CRCSEED are 0xFA); 251=hFB (Bits 23:16 of CRCSEED are 0xFB); 252=hFC (Bits 23:16 of CRCSEED are 0xFC); 253=hFD (Bits 23:16 of CRCSEED are 0xFD); 254=hFE (Bits 23:16 of CRCSEED are 0xFE); 255=hFF (Bits 23:16 of CRCSEED are 0xFF)
0x30001D CONFIG30 reset 0xFF — Non-Boot Sector Seed for CRC on boot bits 15-8
  [7:0] CRCSEEDH
    {v}=h{v:02} (Bits 15:8 of CRCSEED are {0x0+v}) (v=0..9); 10=h0A (Bits 15:8 of CRCSEED are 0x0A); 11=h0B (Bits 15:8 of CRCSEED are 0x0B); 12=h0C (Bits 15:8 of CRCSEED are 0x0C); 13=h0D (Bits 15:8 of CRCSEED are 0x0D); 14=h0E (Bits 15:8 of CRCSEED are 0x0E); 15=h0F (Bits 15:8 of CRCSEED are 0x0F); {v}=h{v-6} (Bits 15:8 of CRCSEED are {0x0+v}) (v=16..25); 26=h1A (Bits 15:8 of CRCSEED are 0x1A); 27=h1B (Bits 15:8 of CRCSEED are 0x1B); 28=h1C (Bits 15:8 of CRCSEED are 0x1C); 29=h1D (Bits 15:8 of CRCSEED are 0x1D); 30=h1E (Bits 15:8 of CRCSEED are 0x1E); 31=h1F (Bits 15:8 of CRCSEED are 0x1F); {v}=h{v-12} (Bits 15:8 of CRCSEED are {0x0+v}) (v=32..41); 42=h2A (Bits 15:8 of CRCSEED are 0x2A); 43=h2B (Bits 15:8 of CRCSEED are 0x2B); 44=h2C (Bits 15:8 of CRCSEED are 0x2C); 45=h2D (Bits 15:8 of CRCSEED are 0x2D); 46=h2E (Bits 15:8 of CRCSEED are 0x2E); 47=h2F (Bits 15:8 of CRCSEED are 0x2F); {v}=h{v-18} (Bits 15:8 of CRCSEED are {0x0+v}) (v=48..57); 58=h3A (Bits 15:8 of CRCSEED are 0x3A); 59=h3B (Bits 15:8 of CRCSEED are 0x3B); 60=h3C (Bits 15:8 of CRCSEED are 0x3C); 61=h3D (Bits 15:8 of CRCSEED are 0x3D); 62=h3E (Bits 15:8 of CRCSEED are 0x3E); 63=h3F (Bits 15:8 of CRCSEED are 0x3F); {v}=h{v-24} (Bits 15:8 of CRCSEED are {0x0+v}) (v=64..73); 74=h4A (Bits 15:8 of CRCSEED are 0x4A); 75=h4B (Bits 15:8 of CRCSEED are 0x4B); 76=h4C (Bits 15:8 of CRCSEED are 0x4C); 77=h4D (Bits 15:8 of CRCSEED are 0x4D); 78=h4E (Bits 15:8 of CRCSEED are 0x4E); 79=h4F (Bits 15:8 of CRCSEED are 0x4F); {v}=h{v-30} (Bits 15:8 of CRCSEED are {0x0+v}) (v=80..89); 90=h5A (Bits 15:8 of CRCSEED are 0x5A); 91=h5B (Bits 15:8 of CRCSEED are 0x5B); 92=h5C (Bits 15:8 of CRCSEED are 0x5C); 93=h5D (Bits 15:8 of CRCSEED are 0x5D); 94=h5E (Bits 15:8 of CRCSEED are 0x5E); 95=h5F (Bits 15:8 of CRCSEED are 0x5F); {v}=h{v-36} (Bits 15:8 of CRCSEED are {0x0+v}) (v=96..105); 106=h6A (Bits 15:8 of CRCSEED are 0x6A); 107=h6B (Bits 15:8 of CRCSEED are 0x6B); 108=h6C (Bits 15:8 of CRCSEED are 0x6C); 109=h6D (Bits 15:8 of CRCSEED are 0x6D); 110=h6E (Bits 15:8 of CRCSEED are 0x6E); 111=h6F (Bits 15:8 of CRCSEED are 0x6F); {v}=h{v-42} (Bits 15:8 of CRCSEED are {0x0+v}) (v=112..121); 122=h7A (Bits 15:8 of CRCSEED are 0x7A); 123=h7B (Bits 15:8 of CRCSEED are 0x7B); 124=h7C (Bits 15:8 of CRCSEED are 0x7C); 125=h7D (Bits 15:8 of CRCSEED are 0x7D); 126=h7E (Bits 15:8 of CRCSEED are 0x7E); 127=h7F (Bits 15:8 of CRCSEED are 0x7F); {v}=h{v-48} (Bits 15:8 of CRCSEED are {0x0+v}) (v=128..137); 138=h8A (Bits 15:8 of CRCSEED are 0x8A); 139=h8B (Bits 15:8 of CRCSEED are 0x8B); 140=h8C (Bits 15:8 of CRCSEED are 0x8C); 141=h8D (Bits 15:8 of CRCSEED are 0x8D); 142=h8E (Bits 15:8 of CRCSEED are 0x8E); 143=h8F (Bits 15:8 of CRCSEED are 0x8F); {v}=h{v-54} (Bits 15:8 of CRCSEED are {0x0+v}) (v=144..153); 154=h9A (Bits 15:8 of CRCSEED are 0x9A); 155=h9B (Bits 15:8 of CRCSEED are 0x9B); 156=h9C (Bits 15:8 of CRCSEED are 0x9C); 157=h9D (Bits 15:8 of CRCSEED are 0x9D); 158=h9E (Bits 15:8 of CRCSEED are 0x9E); 159=h9F (Bits 15:8 of CRCSEED are 0x9F); {v}=hA{v-160} (Bits 15:8 of CRCSEED are {0x0+v}) (v=160..169); 170=hAA (Bits 15:8 of CRCSEED are 0xAA); 171=hAB (Bits 15:8 of CRCSEED are 0xAB); 172=hAC (Bits 15:8 of CRCSEED are 0xAC); 173=hAD (Bits 15:8 of CRCSEED are 0xAD); 174=hAE (Bits 15:8 of CRCSEED are 0xAE); 175=hAF (Bits 15:8 of CRCSEED are 0xAF); {v}=hB{v-176} (Bits 15:8 of CRCSEED are {0x0+v}) (v=176..185); 186=hBA (Bits 15:8 of CRCSEED are 0xBA); 187=hBB (Bits 15:8 of CRCSEED are 0xBB); 188=hBC (Bits 15:8 of CRCSEED are 0xBC); 189=hBD (Bits 15:8 of CRCSEED are 0xBD); 190=hBE (Bits 15:8 of CRCSEED are 0xBE); 191=hBF (Bits 15:8 of CRCSEED are 0xBF); {v}=hC{v-192} (Bits 15:8 of CRCSEED are {0x0+v}) (v=192..201); 202=hCA (Bits 15:8 of CRCSEED are 0xCA); 203=hCB (Bits 15:8 of CRCSEED are 0xCB); 204=hCC (Bits 15:8 of CRCSEED are 0xCC); 205=hCD (Bits 15:8 of CRCSEED are 0xCD); 206=hCE (Bits 15:8 of CRCSEED are 0xCE); 207=hCF (Bits 15:8 of CRCSEED are 0xCF); {v}=hD{v-208} (Bits 15:8 of CRCSEED are {0x0+v}) (v=208..217); 218=hDA (Bits 15:8 of CRCSEED are 0xDA); 219=hDB (Bits 15:8 of CRCSEED are 0xDB); 220=hDC (Bits 15:8 of CRCSEED are 0xDC); 221=hDD (Bits 15:8 of CRCSEED are 0xDD); 222=hDE (Bits 15:8 of CRCSEED are 0xDE); 223=hDF (Bits 15:8 of CRCSEED are 0xDF); {v}=hE{v-224} (Bits 15:8 of CRCSEED are {0x0+v}) (v=224..233); 234=hEA (Bits 15:8 of CRCSEED are 0xEA); 235=hEB (Bits 15:8 of CRCSEED are 0xEB); 236=hEC (Bits 15:8 of CRCSEED are 0xEC); 237=hED (Bits 15:8 of CRCSEED are 0xED); 238=hEE (Bits 15:8 of CRCSEED are 0xEE); 239=hEF (Bits 15:8 of CRCSEED are 0xEF); {v}=hF{v-240} (Bits 15:8 of CRCSEED are {0x0+v}) (v=240..249); 250=hFA (Bits 15:8 of CRCSEED are 0xFA); 251=hFB (Bits 15:8 of CRCSEED are 0xFB); 252=hFC (Bits 15:8 of CRCSEED are 0xFC); 253=hFD (Bits 15:8 of CRCSEED are 0xFD); 254=hFE (Bits 15:8 of CRCSEED are 0xFE); 255=hFF (Bits 15:8 of CRCSEED are 0xFF)
0x30001E CONFIG31 reset 0xFF — Non-Boot Sector Seed for CRC on boot bits 7-0
  [7:0] CRCSEEDL
    {v}=h{v:02} (Bits 7:0 of CRCSEED are {0x0+v}) (v=0..9); 10=h0A (Bits 7:0 of CRCSEED are 0x0A); 11=h0B (Bits 7:0 of CRCSEED are 0x0B); 12=h0C (Bits 7:0 of CRCSEED are 0x0C); 13=h0D (Bits 7:0 of CRCSEED are 0x0D); 14=h0E (Bits 7:0 of CRCSEED are 0x0E); 15=h0F (Bits 7:0 of CRCSEED are 0x0F); {v}=h{v-6} (Bits 7:0 of CRCSEED are {0x0+v}) (v=16..25); 26=h1A (Bits 7:0 of CRCSEED are 0x1A); 27=h1B (Bits 7:0 of CRCSEED are 0x1B); 28=h1C (Bits 7:0 of CRCSEED are 0x1C); 29=h1D (Bits 7:0 of CRCSEED are 0x1D); 30=h1E (Bits 7:0 of CRCSEED are 0x1E); 31=h1F (Bits 7:0 of CRCSEED are 0x1F); {v}=h{v-12} (Bits 7:0 of CRCSEED are {0x0+v}) (v=32..41); 42=h2A (Bits 7:0 of CRCSEED are 0x2A); 43=h2B (Bits 7:0 of CRCSEED are 0x2B); 44=h2C (Bits 7:0 of CRCSEED are 0x2C); 45=h2D (Bits 7:0 of CRCSEED are 0x2D); 46=h2E (Bits 7:0 of CRCSEED are 0x2E); 47=h2F (Bits 7:0 of CRCSEED are 0x2F); {v}=h{v-18} (Bits 7:0 of CRCSEED are {0x0+v}) (v=48..57); 58=h3A (Bits 7:0 of CRCSEED are 0x3A); 59=h3B (Bits 7:0 of CRCSEED are 0x3B); 60=h3C (Bits 7:0 of CRCSEED are 0x3C); 61=h3D (Bits 7:0 of CRCSEED are 0x3D); 62=h3E (Bits 7:0 of CRCSEED are 0x3E); 63=h3F (Bits 7:0 of CRCSEED are 0x3F); {v}=h{v-24} (Bits 7:0 of CRCSEED are {0x0+v}) (v=64..73); 74=h4A (Bits 7:0 of CRCSEED are 0x4A); 75=h4B (Bits 7:0 of CRCSEED are 0x4B); 76=h4C (Bits 7:0 of CRCSEED are 0x4C); 77=h4D (Bits 7:0 of CRCSEED are 0x4D); 78=h4E (Bits 7:0 of CRCSEED are 0x4E); 79=h4F (Bits 7:0 of CRCSEED are 0x4F); {v}=h{v-30} (Bits 7:0 of CRCSEED are {0x0+v}) (v=80..89); 90=h5A (Bits 7:0 of CRCSEED are 0x5A); 91=h5B (Bits 7:0 of CRCSEED are 0x5B); 92=h5C (Bits 7:0 of CRCSEED are 0x5C); 93=h5D (Bits 7:0 of CRCSEED are 0x5D); 94=h5E (Bits 7:0 of CRCSEED are 0x5E); 95=h5F (Bits 7:0 of CRCSEED are 0x5F); {v}=h{v-36} (Bits 7:0 of CRCSEED are {0x0+v}) (v=96..105); 106=h6A (Bits 7:0 of CRCSEED are 0x6A); 107=h6B (Bits 7:0 of CRCSEED are 0x6B); 108=h6C (Bits 7:0 of CRCSEED are 0x6C); 109=h6D (Bits 7:0 of CRCSEED are 0x6D); 110=h6E (Bits 7:0 of CRCSEED are 0x6E); 111=h6F (Bits 7:0 of CRCSEED are 0x6F); {v}=h{v-42} (Bits 7:0 of CRCSEED are {0x0+v}) (v=112..121); 122=h7A (Bits 7:0 of CRCSEED are 0x7A); 123=h7B (Bits 7:0 of CRCSEED are 0x7B); 124=h7C (Bits 7:0 of CRCSEED are 0x7C); 125=h7D (Bits 7:0 of CRCSEED are 0x7D); 126=h7E (Bits 7:0 of CRCSEED are 0x7E); 127=h7F (Bits 7:0 of CRCSEED are 0x7F); {v}=h{v-48} (Bits 7:0 of CRCSEED are {0x0+v}) (v=128..137); 138=h8A (Bits 7:0 of CRCSEED are 0x8A); 139=h8B (Bits 7:0 of CRCSEED are 0x8B); 140=h8C (Bits 7:0 of CRCSEED are 0x8C); 141=h8D (Bits 7:0 of CRCSEED are 0x8D); 142=h8E (Bits 7:0 of CRCSEED are 0x8E); 143=h8F (Bits 7:0 of CRCSEED are 0x8F); {v}=h{v-54} (Bits 7:0 of CRCSEED are {0x0+v}) (v=144..153); 154=h9A (Bits 7:0 of CRCSEED are 0x9A); 155=h9B (Bits 7:0 of CRCSEED are 0x9B); 156=h9C (Bits 7:0 of CRCSEED are 0x9C); 157=h9D (Bits 7:0 of CRCSEED are 0x9D); 158=h9E (Bits 7:0 of CRCSEED are 0x9E); 159=h9F (Bits 7:0 of CRCSEED are 0x9F); {v}=hA{v-160} (Bits 7:0 of CRCSEED are {0x0+v}) (v=160..169); 170=hAA (Bits 7:0 of CRCSEED are 0xAA); 171=hAB (Bits 7:0 of CRCSEED are 0xAB); 172=hAC (Bits 7:0 of CRCSEED are 0xAC); 173=hAD (Bits 7:0 of CRCSEED are 0xAD); 174=hAE (Bits 7:0 of CRCSEED are 0xAE); 175=hAF (Bits 7:0 of CRCSEED are 0xAF); {v}=hB{v-176} (Bits 7:0 of CRCSEED are {0x0+v}) (v=176..185); 186=hBA (Bits 7:0 of CRCSEED are 0xBA); 187=hBB (Bits 7:0 of CRCSEED are 0xBB); 188=hBC (Bits 7:0 of CRCSEED are 0xBC); 189=hBD (Bits 7:0 of CRCSEED are 0xBD); 190=hBE (Bits 7:0 of CRCSEED are 0xBE); 191=hBF (Bits 7:0 of CRCSEED are 0xBF); {v}=hC{v-192} (Bits 7:0 of CRCSEED are {0x0+v}) (v=192..201); 202=hCA (Bits 7:0 of CRCSEED are 0xCA); 203=hCB (Bits 7:0 of CRCSEED are 0xCB); 204=hCC (Bits 7:0 of CRCSEED are 0xCC); 205=hCD (Bits 7:0 of CRCSEED are 0xCD); 206=hCE (Bits 7:0 of CRCSEED are 0xCE); 207=hCF (Bits 7:0 of CRCSEED are 0xCF); {v}=hD{v-208} (Bits 7:0 of CRCSEED are {0x0+v}) (v=208..217); 218=hDA (Bits 7:0 of CRCSEED are 0xDA); 219=hDB (Bits 7:0 of CRCSEED are 0xDB); 220=hDC (Bits 7:0 of CRCSEED are 0xDC); 221=hDD (Bits 7:0 of CRCSEED are 0xDD); 222=hDE (Bits 7:0 of CRCSEED are 0xDE); 223=hDF (Bits 7:0 of CRCSEED are 0xDF); {v}=hE{v-224} (Bits 7:0 of CRCSEED are {0x0+v}) (v=224..233); 234=hEA (Bits 7:0 of CRCSEED are 0xEA); 235=hEB (Bits 7:0 of CRCSEED are 0xEB); 236=hEC (Bits 7:0 of CRCSEED are 0xEC); 237=hED (Bits 7:0 of CRCSEED are 0xED); 238=hEE (Bits 7:0 of CRCSEED are 0xEE); 239=hEF (Bits 7:0 of CRCSEED are 0xEF); {v}=hF{v-240} (Bits 7:0 of CRCSEED are {0x0+v}) (v=240..249); 250=hFA (Bits 7:0 of CRCSEED are 0xFA); 251=hFB (Bits 7:0 of CRCSEED are 0xFB); 252=hFC (Bits 7:0 of CRCSEED are 0xFC); 253=hFD (Bits 7:0 of CRCSEED are 0xFD); 254=hFE (Bits 7:0 of CRCSEED are 0xFE); 255=hFF (Bits 7:0 of CRCSEED are 0xFF)
0x30001F CONFIG32 reset 0xFF — Non-Boot Sector Expected Result for CRC on boot bits 31-24
  [7:0] CRCEREST
    {v}=h{v:02} (Bits 31:24 of CRCERES are {0x0+v}) (v=0..9); 10=h0A (Bits 31:24 of CRCERES are 0x0A); 11=h0B (Bits 31:24 of CRCERES are 0x0B); 12=h0C (Bits 31:24 of CRCERES are 0x0C); 13=h0D (Bits 31:24 of CRCERES are 0x0D); 14=h0E (Bits 31:24 of CRCERES are 0x0E); 15=h0F (Bits 31:24 of CRCERES are 0x0F); {v}=h{v-6} (Bits 31:24 of CRCERES are {0x0+v}) (v=16..25); 26=h1A (Bits 31:24 of CRCERES are 0x1A); 27=h1B (Bits 31:24 of CRCERES are 0x1B); 28=h1C (Bits 31:24 of CRCERES are 0x1C); 29=h1D (Bits 31:24 of CRCERES are 0x1D); 30=h1E (Bits 31:24 of CRCERES are 0x1E); 31=h1F (Bits 31:24 of CRCERES are 0x1F); {v}=h{v-12} (Bits 31:24 of CRCERES are {0x0+v}) (v=32..41); 42=h2A (Bits 31:24 of CRCERES are 0x2A); 43=h2B (Bits 31:24 of CRCERES are 0x2B); 44=h2C (Bits 31:24 of CRCERES are 0x2C); 45=h2D (Bits 31:24 of CRCERES are 0x2D); 46=h2E (Bits 31:24 of CRCERES are 0x2E); 47=h2F (Bits 31:24 of CRCERES are 0x2F); {v}=h{v-18} (Bits 31:24 of CRCERES are {0x0+v}) (v=48..57); 58=h3A (Bits 31:24 of CRCERES are 0x3A); 59=h3B (Bits 31:24 of CRCERES are 0x3B); 60=h3C (Bits 31:24 of CRCERES are 0x3C); 61=h3D (Bits 31:24 of CRCERES are 0x3D); 62=h3E (Bits 31:24 of CRCERES are 0x3E); 63=h3F (Bits 31:24 of CRCERES are 0x3F); {v}=h{v-24} (Bits 31:24 of CRCERES are {0x0+v}) (v=64..73); 74=h4A (Bits 31:24 of CRCERES are 0x4A); 75=h4B (Bits 31:24 of CRCERES are 0x4B); 76=h4C (Bits 31:24 of CRCERES are 0x4C); 77=h4D (Bits 31:24 of CRCERES are 0x4D); 78=h4E (Bits 31:24 of CRCERES are 0x4E); 79=h4F (Bits 31:24 of CRCERES are 0x4F); {v}=h{v-30} (Bits 31:24 of CRCERES are {0x0+v}) (v=80..89); 90=h5A (Bits 31:24 of CRCERES are 0x5A); 91=h5B (Bits 31:24 of CRCERES are 0x5B); 92=h5C (Bits 31:24 of CRCERES are 0x5C); 93=h5D (Bits 31:24 of CRCERES are 0x5D); 94=h5E (Bits 31:24 of CRCERES are 0x5E); 95=h5F (Bits 31:24 of CRCERES are 0x5F); {v}=h{v-36} (Bits 31:24 of CRCERES are {0x0+v}) (v=96..105); 106=h6A (Bits 31:24 of CRCERES are 0x6A); 107=h6B (Bits 31:24 of CRCERES are 0x6B); 108=h6C (Bits 31:24 of CRCERES are 0x6C); 109=h6D (Bits 31:24 of CRCERES are 0x6D); 110=h6E (Bits 31:24 of CRCERES are 0x6E); 111=h6F (Bits 31:24 of CRCERES are 0x6F); {v}=h{v-42} (Bits 31:24 of CRCERES are {0x0+v}) (v=112..121); 122=h7A (Bits 31:24 of CRCERES are 0x7A); 123=h7B (Bits 31:24 of CRCERES are 0x7B); 124=h7C (Bits 31:24 of CRCERES are 0x7C); 125=h7D (Bits 31:24 of CRCERES are 0x7D); 126=h7E (Bits 31:24 of CRCERES are 0x7E); 127=h7F (Bits 31:24 of CRCERES are 0x7F); {v}=h{v-48} (Bits 31:24 of CRCERES are {0x0+v}) (v=128..137); 138=h8A (Bits 31:24 of CRCERES are 0x8A); 139=h8B (Bits 31:24 of CRCERES are 0x8B); 140=h8C (Bits 31:24 of CRCERES are 0x8C); 141=h8D (Bits 31:24 of CRCERES are 0x8D); 142=h8E (Bits 31:24 of CRCERES are 0x8E); 143=h8F (Bits 31:24 of CRCERES are 0x8F); {v}=h{v-54} (Bits 31:24 of CRCERES are {0x0+v}) (v=144..153); 154=h9A (Bits 31:24 of CRCERES are 0x9A); 155=h9B (Bits 31:24 of CRCERES are 0x9B); 156=h9C (Bits 31:24 of CRCERES are 0x9C); 157=h9D (Bits 31:24 of CRCERES are 0x9D); 158=h9E (Bits 31:24 of CRCERES are 0x9E); 159=h9F (Bits 31:24 of CRCERES are 0x9F); {v}=hA{v-160} (Bits 31:24 of CRCERES are {0x0+v}) (v=160..169); 170=hAA (Bits 31:24 of CRCERES are 0xAA); 171=hAB (Bits 31:24 of CRCERES are 0xAB); 172=hAC (Bits 31:24 of CRCERES are 0xAC); 173=hAD (Bits 31:24 of CRCERES are 0xAD); 174=hAE (Bits 31:24 of CRCERES are 0xAE); 175=hAF (Bits 31:24 of CRCERES are 0xAF); {v}=hB{v-176} (Bits 31:24 of CRCERES are {0x0+v}) (v=176..185); 186=hBA (Bits 31:24 of CRCERES are 0xBA); 187=hBB (Bits 31:24 of CRCERES are 0xBB); 188=hBC (Bits 31:24 of CRCERES are 0xBC); 189=hBD (Bits 31:24 of CRCERES are 0xBD); 190=hBE (Bits 31:24 of CRCERES are 0xBE); 191=hBF (Bits 31:24 of CRCERES are 0xBF); {v}=hC{v-192} (Bits 31:24 of CRCERES are {0x0+v}) (v=192..201); 202=hCA (Bits 31:24 of CRCERES are 0xCA); 203=hCB (Bits 31:24 of CRCERES are 0xCB); 204=hCC (Bits 31:24 of CRCERES are 0xCC); 205=hCD (Bits 31:24 of CRCERES are 0xCD); 206=hCE (Bits 31:24 of CRCERES are 0xCE); 207=hCF (Bits 31:24 of CRCERES are 0xCF); {v}=hD{v-208} (Bits 31:24 of CRCERES are {0x0+v}) (v=208..217); 218=hDA (Bits 31:24 of CRCERES are 0xDA); 219=hDB (Bits 31:24 of CRCERES are 0xDB); 220=hDC (Bits 31:24 of CRCERES are 0xDC); 221=hDD (Bits 31:24 of CRCERES are 0xDD); 222=hDE (Bits 31:24 of CRCERES are 0xDE); 223=hDF (Bits 31:24 of CRCERES are 0xDF); {v}=hE{v-224} (Bits 31:24 of CRCERES are {0x0+v}) (v=224..233); 234=hEA (Bits 31:24 of CRCERES are 0xEA); 235=hEB (Bits 31:24 of CRCERES are 0xEB); 236=hEC (Bits 31:24 of CRCERES are 0xEC); 237=hED (Bits 31:24 of CRCERES are 0xED); 238=hEE (Bits 31:24 of CRCERES are 0xEE); 239=hEF (Bits 31:24 of CRCERES are 0xEF); {v}=hF{v-240} (Bits 31:24 of CRCERES are {0x0+v}) (v=240..249); 250=hFA (Bits 31:24 of CRCERES are 0xFA); 251=hFB (Bits 31:24 of CRCERES are 0xFB); 252=hFC (Bits 31:24 of CRCERES are 0xFC); 253=hFD (Bits 31:24 of CRCERES are 0xFD); 254=hFE (Bits 31:24 of CRCERES are 0xFE); 255=hFF (Bits 31:24 of CRCERES are 0xFF)
0x300020 CONFIG33 reset 0xFF — Non-Boot Sector Expected Result for CRC on boot bits 23-16
  [7:0] CRCERESU
    {v}=h{v:02} (Bits 23:16 of CRCERES are {0x0+v}) (v=0..9); 10=h0A (Bits 23:16 of CRCERES are 0x0A); 11=h0B (Bits 23:16 of CRCERES are 0x0B); 12=h0C (Bits 23:16 of CRCERES are 0x0C); 13=h0D (Bits 23:16 of CRCERES are 0x0D); 14=h0E (Bits 23:16 of CRCERES are 0x0E); 15=h0F (Bits 23:16 of CRCERES are 0x0F); {v}=h{v-6} (Bits 23:16 of CRCERES are {0x0+v}) (v=16..25); 26=h1A (Bits 23:16 of CRCERES are 0x1A); 27=h1B (Bits 23:16 of CRCERES are 0x1B); 28=h1C (Bits 23:16 of CRCERES are 0x1C); 29=h1D (Bits 23:16 of CRCERES are 0x1D); 30=h1E (Bits 23:16 of CRCERES are 0x1E); 31=h1F (Bits 23:16 of CRCERES are 0x1F); {v}=h{v-12} (Bits 23:16 of CRCERES are {0x0+v}) (v=32..41); 42=h2A (Bits 23:16 of CRCERES are 0x2A); 43=h2B (Bits 23:16 of CRCERES are 0x2B); 44=h2C (Bits 23:16 of CRCERES are 0x2C); 45=h2D (Bits 23:16 of CRCERES are 0x2D); 46=h2E (Bits 23:16 of CRCERES are 0x2E); 47=h2F (Bits 23:16 of CRCERES are 0x2F); {v}=h{v-18} (Bits 23:16 of CRCERES are {0x0+v}) (v=48..57); 58=h3A (Bits 23:16 of CRCERES are 0x3A); 59=h3B (Bits 23:16 of CRCERES are 0x3B); 60=h3C (Bits 23:16 of CRCERES are 0x3C); 61=h3D (Bits 23:16 of CRCERES are 0x3D); 62=h3E (Bits 23:16 of CRCERES are 0x3E); 63=h3F (Bits 23:16 of CRCERES are 0x3F); {v}=h{v-24} (Bits 23:16 of CRCERES are {0x0+v}) (v=64..73); 74=h4A (Bits 23:16 of CRCERES are 0x4A); 75=h4B (Bits 23:16 of CRCERES are 0x4B); 76=h4C (Bits 23:16 of CRCERES are 0x4C); 77=h4D (Bits 23:16 of CRCERES are 0x4D); 78=h4E (Bits 23:16 of CRCERES are 0x4E); 79=h4F (Bits 23:16 of CRCERES are 0x4F); {v}=h{v-30} (Bits 23:16 of CRCERES are {0x0+v}) (v=80..89); 90=h5A (Bits 23:16 of CRCERES are 0x5A); 91=h5B (Bits 23:16 of CRCERES are 0x5B); 92=h5C (Bits 23:16 of CRCERES are 0x5C); 93=h5D (Bits 23:16 of CRCERES are 0x5D); 94=h5E (Bits 23:16 of CRCERES are 0x5E); 95=h5F (Bits 23:16 of CRCERES are 0x5F); {v}=h{v-36} (Bits 23:16 of CRCERES are {0x0+v}) (v=96..105); 106=h6A (Bits 23:16 of CRCERES are 0x6A); 107=h6B (Bits 23:16 of CRCERES are 0x6B); 108=h6C (Bits 23:16 of CRCERES are 0x6C); 109=h6D (Bits 23:16 of CRCERES are 0x6D); 110=h6E (Bits 23:16 of CRCERES are 0x6E); 111=h6F (Bits 23:16 of CRCERES are 0x6F); {v}=h{v-42} (Bits 23:16 of CRCERES are {0x0+v}) (v=112..121); 122=h7A (Bits 23:16 of CRCERES are 0x7A); 123=h7B (Bits 23:16 of CRCERES are 0x7B); 124=h7C (Bits 23:16 of CRCERES are 0x7C); 125=h7D (Bits 23:16 of CRCERES are 0x7D); 126=h7E (Bits 23:16 of CRCERES are 0x7E); 127=h7F (Bits 23:16 of CRCERES are 0x7F); {v}=h{v-48} (Bits 23:16 of CRCERES are {0x0+v}) (v=128..137); 138=h8A (Bits 23:16 of CRCERES are 0x8A); 139=h8B (Bits 23:16 of CRCERES are 0x8B); 140=h8C (Bits 23:16 of CRCERES are 0x8C); 141=h8D (Bits 23:16 of CRCERES are 0x8D); 142=h8E (Bits 23:16 of CRCERES are 0x8E); 143=h8F (Bits 23:16 of CRCERES are 0x8F); {v}=h{v-54} (Bits 23:16 of CRCERES are {0x0+v}) (v=144..153); 154=h9A (Bits 23:16 of CRCERES are 0x9A); 155=h9B (Bits 23:16 of CRCERES are 0x9B); 156=h9C (Bits 23:16 of CRCERES are 0x9C); 157=h9D (Bits 23:16 of CRCERES are 0x9D); 158=h9E (Bits 23:16 of CRCERES are 0x9E); 159=h9F (Bits 23:16 of CRCERES are 0x9F); {v}=hA{v-160} (Bits 23:16 of CRCERES are {0x0+v}) (v=160..169); 170=hAA (Bits 23:16 of CRCERES are 0xAA); 171=hAB (Bits 23:16 of CRCERES are 0xAB); 172=hAC (Bits 23:16 of CRCERES are 0xAC); 173=hAD (Bits 23:16 of CRCERES are 0xAD); 174=hAE (Bits 23:16 of CRCERES are 0xAE); 175=hAF (Bits 23:16 of CRCERES are 0xAF); {v}=hB{v-176} (Bits 23:16 of CRCERES are {0x0+v}) (v=176..185); 186=hBA (Bits 23:16 of CRCERES are 0xBA); 187=hBB (Bits 23:16 of CRCERES are 0xBB); 188=hBC (Bits 23:16 of CRCERES are 0xBC); 189=hBD (Bits 23:16 of CRCERES are 0xBD); 190=hBE (Bits 23:16 of CRCERES are 0xBE); 191=hBF (Bits 23:16 of CRCERES are 0xBF); {v}=hC{v-192} (Bits 23:16 of CRCERES are {0x0+v}) (v=192..201); 202=hCA (Bits 23:16 of CRCERES are 0xCA); 203=hCB (Bits 23:16 of CRCERES are 0xCB); 204=hCC (Bits 23:16 of CRCERES are 0xCC); 205=hCD (Bits 23:16 of CRCERES are 0xCD); 206=hCE (Bits 23:16 of CRCERES are 0xCE); 207=hCF (Bits 23:16 of CRCERES are 0xCF); {v}=hD{v-208} (Bits 23:16 of CRCERES are {0x0+v}) (v=208..217); 218=hDA (Bits 23:16 of CRCERES are 0xDA); 219=hDB (Bits 23:16 of CRCERES are 0xDB); 220=hDC (Bits 23:16 of CRCERES are 0xDC); 221=hDD (Bits 23:16 of CRCERES are 0xDD); 222=hDE (Bits 23:16 of CRCERES are 0xDE); 223=hDF (Bits 23:16 of CRCERES are 0xDF); {v}=hE{v-224} (Bits 23:16 of CRCERES are {0x0+v}) (v=224..233); 234=hEA (Bits 23:16 of CRCERES are 0xEA); 235=hEB (Bits 23:16 of CRCERES are 0xEB); 236=hEC (Bits 23:16 of CRCERES are 0xEC); 237=hED (Bits 23:16 of CRCERES are 0xED); 238=hEE (Bits 23:16 of CRCERES are 0xEE); 239=hEF (Bits 23:16 of CRCERES are 0xEF); {v}=hF{v-240} (Bits 23:16 of CRCERES are {0x0+v}) (v=240..249); 250=hFA (Bits 23:16 of CRCERES are 0xFA); 251=hFB (Bits 23:16 of CRCERES are 0xFB); 252=hFC (Bits 23:16 of CRCERES are 0xFC); 253=hFD (Bits 23:16 of CRCERES are 0xFD); 254=hFE (Bits 23:16 of CRCERES are 0xFE); 255=hFF (Bits 23:16 of CRCERES are 0xFF)
0x300021 CONFIG34 reset 0xFF — Non-Boot Sector Expected Result for CRC on boot bits 15-8
  [7:0] CRCERESH
    {v}=h{v:02} (Bits 15:8 of CRCERES are {0x0+v}) (v=0..9); 10=h0A (Bits 15:8 of CRCERES are 0x0A); 11=h0B (Bits 15:8 of CRCERES are 0x0B); 12=h0C (Bits 15:8 of CRCERES are 0x0C); 13=h0D (Bits 15:8 of CRCERES are 0x0D); 14=h0E (Bits 15:8 of CRCERES are 0x0E); 15=h0F (Bits 15:8 of CRCERES are 0x0F); {v}=h{v-6} (Bits 15:8 of CRCERES are {0x0+v}) (v=16..25); 26=h1A (Bits 15:8 of CRCERES are 0x1A); 27=h1B (Bits 15:8 of CRCERES are 0x1B); 28=h1C (Bits 15:8 of CRCERES are 0x1C); 29=h1D (Bits 15:8 of CRCERES are 0x1D); 30=h1E (Bits 15:8 of CRCERES are 0x1E); 31=h1F (Bits 15:8 of CRCERES are 0x1F); {v}=h{v-12} (Bits 15:8 of CRCERES are {0x0+v}) (v=32..41); 42=h2A (Bits 15:8 of CRCERES are 0x2A); 43=h2B (Bits 15:8 of CRCERES are 0x2B); 44=h2C (Bits 15:8 of CRCERES are 0x2C); 45=h2D (Bits 15:8 of CRCERES are 0x2D); 46=h2E (Bits 15:8 of CRCERES are 0x2E); 47=h2F (Bits 15:8 of CRCERES are 0x2F); {v}=h{v-18} (Bits 15:8 of CRCERES are {0x0+v}) (v=48..57); 58=h3A (Bits 15:8 of CRCERES are 0x3A); 59=h3B (Bits 15:8 of CRCERES are 0x3B); 60=h3C (Bits 15:8 of CRCERES are 0x3C); 61=h3D (Bits 15:8 of CRCERES are 0x3D); 62=h3E (Bits 15:8 of CRCERES are 0x3E); 63=h3F (Bits 15:8 of CRCERES are 0x3F); {v}=h{v-24} (Bits 15:8 of CRCERES are {0x0+v}) (v=64..73); 74=h4A (Bits 15:8 of CRCERES are 0x4A); 75=h4B (Bits 15:8 of CRCERES are 0x4B); 76=h4C (Bits 15:8 of CRCERES are 0x4C); 77=h4D (Bits 15:8 of CRCERES are 0x4D); 78=h4E (Bits 15:8 of CRCERES are 0x4E); 79=h4F (Bits 15:8 of CRCERES are 0x4F); {v}=h{v-30} (Bits 15:8 of CRCERES are {0x0+v}) (v=80..89); 90=h5A (Bits 15:8 of CRCERES are 0x5A); 91=h5B (Bits 15:8 of CRCERES are 0x5B); 92=h5C (Bits 15:8 of CRCERES are 0x5C); 93=h5D (Bits 15:8 of CRCERES are 0x5D); 94=h5E (Bits 15:8 of CRCERES are 0x5E); 95=h5F (Bits 15:8 of CRCERES are 0x5F); {v}=h{v-36} (Bits 15:8 of CRCERES are {0x0+v}) (v=96..105); 106=h6A (Bits 15:8 of CRCERES are 0x6A); 107=h6B (Bits 15:8 of CRCERES are 0x6B); 108=h6C (Bits 15:8 of CRCERES are 0x6C); 109=h6D (Bits 15:8 of CRCERES are 0x6D); 110=h6E (Bits 15:8 of CRCERES are 0x6E); 111=h6F (Bits 15:8 of CRCERES are 0x6F); {v}=h{v-42} (Bits 15:8 of CRCERES are {0x0+v}) (v=112..121); 122=h7A (Bits 15:8 of CRCERES are 0x7A); 123=h7B (Bits 15:8 of CRCERES are 0x7B); 124=h7C (Bits 15:8 of CRCERES are 0x7C); 125=h7D (Bits 15:8 of CRCERES are 0x7D); 126=h7E (Bits 15:8 of CRCERES are 0x7E); 127=h7F (Bits 15:8 of CRCERES are 0x7F); {v}=h{v-48} (Bits 15:8 of CRCERES are {0x0+v}) (v=128..137); 138=h8A (Bits 15:8 of CRCERES are 0x8A); 139=h8B (Bits 15:8 of CRCERES are 0x8B); 140=h8C (Bits 15:8 of CRCERES are 0x8C); 141=h8D (Bits 15:8 of CRCERES are 0x8D); 142=h8E (Bits 15:8 of CRCERES are 0x8E); 143=h8F (Bits 15:8 of CRCERES are 0x8F); {v}=h{v-54} (Bits 15:8 of CRCERES are {0x0+v}) (v=144..153); 154=h9A (Bits 15:8 of CRCERES are 0x9A); 155=h9B (Bits 15:8 of CRCERES are 0x9B); 156=h9C (Bits 15:8 of CRCERES are 0x9C); 157=h9D (Bits 15:8 of CRCERES are 0x9D); 158=h9E (Bits 15:8 of CRCERES are 0x9E); 159=h9F (Bits 15:8 of CRCERES are 0x9F); {v}=hA{v-160} (Bits 15:8 of CRCERES are {0x0+v}) (v=160..169); 170=hAA (Bits 15:8 of CRCERES are 0xAA); 171=hAB (Bits 15:8 of CRCERES are 0xAB); 172=hAC (Bits 15:8 of CRCERES are 0xAC); 173=hAD (Bits 15:8 of CRCERES are 0xAD); 174=hAE (Bits 15:8 of CRCERES are 0xAE); 175=hAF (Bits 15:8 of CRCERES are 0xAF); {v}=hB{v-176} (Bits 15:8 of CRCERES are {0x0+v}) (v=176..185); 186=hBA (Bits 15:8 of CRCERES are 0xBA); 187=hBB (Bits 15:8 of CRCERES are 0xBB); 188=hBC (Bits 15:8 of CRCERES are 0xBC); 189=hBD (Bits 15:8 of CRCERES are 0xBD); 190=hBE (Bits 15:8 of CRCERES are 0xBE); 191=hBF (Bits 15:8 of CRCERES are 0xBF); {v}=hC{v-192} (Bits 15:8 of CRCERES are {0x0+v}) (v=192..201); 202=hCA (Bits 15:8 of CRCERES are 0xCA); 203=hCB (Bits 15:8 of CRCERES are 0xCB); 204=hCC (Bits 15:8 of CRCERES are 0xCC); 205=hCD (Bits 15:8 of CRCERES are 0xCD); 206=hCE (Bits 15:8 of CRCERES are 0xCE); 207=hCF (Bits 15:8 of CRCERES are 0xCF); {v}=hD{v-208} (Bits 15:8 of CRCERES are {0x0+v}) (v=208..217); 218=hDA (Bits 15:8 of CRCERES are 0xDA); 219=hDB (Bits 15:8 of CRCERES are 0xDB); 220=hDC (Bits 15:8 of CRCERES are 0xDC); 221=hDD (Bits 15:8 of CRCERES are 0xDD); 222=hDE (Bits 15:8 of CRCERES are 0xDE); 223=hDF (Bits 15:8 of CRCERES are 0xDF); {v}=hE{v-224} (Bits 15:8 of CRCERES are {0x0+v}) (v=224..233); 234=hEA (Bits 15:8 of CRCERES are 0xEA); 235=hEB (Bits 15:8 of CRCERES are 0xEB); 236=hEC (Bits 15:8 of CRCERES are 0xEC); 237=hED (Bits 15:8 of CRCERES are 0xED); 238=hEE (Bits 15:8 of CRCERES are 0xEE); 239=hEF (Bits 15:8 of CRCERES are 0xEF); {v}=hF{v-240} (Bits 15:8 of CRCERES are {0x0+v}) (v=240..249); 250=hFA (Bits 15:8 of CRCERES are 0xFA); 251=hFB (Bits 15:8 of CRCERES are 0xFB); 252=hFC (Bits 15:8 of CRCERES are 0xFC); 253=hFD (Bits 15:8 of CRCERES are 0xFD); 254=hFE (Bits 15:8 of CRCERES are 0xFE); 255=hFF (Bits 15:8 of CRCERES are 0xFF)
0x300022 CONFIG35 reset 0xFF — Non-Boot Sector Expected Result for CRC on boot bits 7-0
  [7:0] CRCERESL
    {v}=h{v:02} (Bits 7:0 of CRCERES are {0x0+v}) (v=0..9); 10=h0A (Bits 7:0 of CRCERES are 0x0A); 11=h0B (Bits 7:0 of CRCERES are 0x0B); 12=h0C (Bits 7:0 of CRCERES are 0x0C); 13=h0D (Bits 7:0 of CRCERES are 0x0D); 14=h0E (Bits 7:0 of CRCERES are 0x0E); 15=h0F (Bits 7:0 of CRCERES are 0x0F); {v}=h{v-6} (Bits 7:0 of CRCERES are {0x0+v}) (v=16..25); 26=h1A (Bits 7:0 of CRCERES are 0x1A); 27=h1B (Bits 7:0 of CRCERES are 0x1B); 28=h1C (Bits 7:0 of CRCERES are 0x1C); 29=h1D (Bits 7:0 of CRCERES are 0x1D); 30=h1E (Bits 7:0 of CRCERES are 0x1E); 31=h1F (Bits 7:0 of CRCERES are 0x1F); {v}=h{v-12} (Bits 7:0 of CRCERES are {0x0+v}) (v=32..41); 42=h2A (Bits 7:0 of CRCERES are 0x2A); 43=h2B (Bits 7:0 of CRCERES are 0x2B); 44=h2C (Bits 7:0 of CRCERES are 0x2C); 45=h2D (Bits 7:0 of CRCERES are 0x2D); 46=h2E (Bits 7:0 of CRCERES are 0x2E); 47=h2F (Bits 7:0 of CRCERES are 0x2F); {v}=h{v-18} (Bits 7:0 of CRCERES are {0x0+v}) (v=48..57); 58=h3A (Bits 7:0 of CRCERES are 0x3A); 59=h3B (Bits 7:0 of CRCERES are 0x3B); 60=h3C (Bits 7:0 of CRCERES are 0x3C); 61=h3D (Bits 7:0 of CRCERES are 0x3D); 62=h3E (Bits 7:0 of CRCERES are 0x3E); 63=h3F (Bits 7:0 of CRCERES are 0x3F); {v}=h{v-24} (Bits 7:0 of CRCERES are {0x0+v}) (v=64..73); 74=h4A (Bits 7:0 of CRCERES are 0x4A); 75=h4B (Bits 7:0 of CRCERES are 0x4B); 76=h4C (Bits 7:0 of CRCERES are 0x4C); 77=h4D (Bits 7:0 of CRCERES are 0x4D); 78=h4E (Bits 7:0 of CRCERES are 0x4E); 79=h4F (Bits 7:0 of CRCERES are 0x4F); {v}=h{v-30} (Bits 7:0 of CRCERES are {0x0+v}) (v=80..89); 90=h5A (Bits 7:0 of CRCERES are 0x5A); 91=h5B (Bits 7:0 of CRCERES are 0x5B); 92=h5C (Bits 7:0 of CRCERES are 0x5C); 93=h5D (Bits 7:0 of CRCERES are 0x5D); 94=h5E (Bits 7:0 of CRCERES are 0x5E); 95=h5F (Bits 7:0 of CRCERES are 0x5F); {v}=h{v-36} (Bits 7:0 of CRCERES are {0x0+v}) (v=96..105); 106=h6A (Bits 7:0 of CRCERES are 0x6A); 107=h6B (Bits 7:0 of CRCERES are 0x6B); 108=h6C (Bits 7:0 of CRCERES are 0x6C); 109=h6D (Bits 7:0 of CRCERES are 0x6D); 110=h6E (Bits 7:0 of CRCERES are 0x6E); 111=h6F (Bits 7:0 of CRCERES are 0x6F); {v}=h{v-42} (Bits 7:0 of CRCERES are {0x0+v}) (v=112..121); 122=h7A (Bits 7:0 of CRCERES are 0x7A); 123=h7B (Bits 7:0 of CRCERES are 0x7B); 124=h7C (Bits 7:0 of CRCERES are 0x7C); 125=h7D (Bits 7:0 of CRCERES are 0x7D); 126=h7E (Bits 7:0 of CRCERES are 0x7E); 127=h7F (Bits 7:0 of CRCERES are 0x7F); {v}=h{v-48} (Bits 7:0 of CRCERES are {0x0+v}) (v=128..137); 138=h8A (Bits 7:0 of CRCERES are 0x8A); 139=h8B (Bits 7:0 of CRCERES are 0x8B); 140=h8C (Bits 7:0 of CRCERES are 0x8C); 141=h8D (Bits 7:0 of CRCERES are 0x8D); 142=h8E (Bits 7:0 of CRCERES are 0x8E); 143=h8F (Bits 7:0 of CRCERES are 0x8F); {v}=h{v-54} (Bits 7:0 of CRCERES are {0x0+v}) (v=144..153); 154=h9A (Bits 7:0 of CRCERES are 0x9A); 155=h9B (Bits 7:0 of CRCERES are 0x9B); 156=h9C (Bits 7:0 of CRCERES are 0x9C); 157=h9D (Bits 7:0 of CRCERES are 0x9D); 158=h9E (Bits 7:0 of CRCERES are 0x9E); 159=h9F (Bits 7:0 of CRCERES are 0x9F); {v}=hA{v-160} (Bits 7:0 of CRCERES are {0x0+v}) (v=160..169); 170=hAA (Bits 7:0 of CRCERES are 0xAA); 171=hAB (Bits 7:0 of CRCERES are 0xAB); 172=hAC (Bits 7:0 of CRCERES are 0xAC); 173=hAD (Bits 7:0 of CRCERES are 0xAD); 174=hAE (Bits 7:0 of CRCERES are 0xAE); 175=hAF (Bits 7:0 of CRCERES are 0xAF); {v}=hB{v-176} (Bits 7:0 of CRCERES are {0x0+v}) (v=176..185); 186=hBA (Bits 7:0 of CRCERES are 0xBA); 187=hBB (Bits 7:0 of CRCERES are 0xBB); 188=hBC (Bits 7:0 of CRCERES are 0xBC); 189=hBD (Bits 7:0 of CRCERES are 0xBD); 190=hBE (Bits 7:0 of CRCERES are 0xBE); 191=hBF (Bits 7:0 of CRCERES are 0xBF); {v}=hC{v-192} (Bits 7:0 of CRCERES are {0x0+v}) (v=192..201); 202=hCA (Bits 7:0 of CRCERES are 0xCA); 203=hCB (Bits 7:0 of CRCERES are 0xCB); 204=hCC (Bits 7:0 of CRCERES are 0xCC); 205=hCD (Bits 7:0 of CRCERES are 0xCD); 206=hCE (Bits 7:0 of CRCERES are 0xCE); 207=hCF (Bits 7:0 of CRCERES are 0xCF); {v}=hD{v-208} (Bits 7:0 of CRCERES are {0x0+v}) (v=208..217); 218=hDA (Bits 7:0 of CRCERES are 0xDA); 219=hDB (Bits 7:0 of CRCERES are 0xDB); 220=hDC (Bits 7:0 of CRCERES are 0xDC); 221=hDD (Bits 7:0 of CRCERES are 0xDD); 222=hDE (Bits 7:0 of CRCERES are 0xDE); 223=hDF (Bits 7:0 of CRCERES are 0xDF); {v}=hE{v-224} (Bits 7:0 of CRCERES are {0x0+v}) (v=224..233); 234=hEA (Bits 7:0 of CRCERES are 0xEA); 235=hEB (Bits 7:0 of CRCERES are 0xEB); 236=hEC (Bits 7:0 of CRCERES are 0xEC); 237=hED (Bits 7:0 of CRCERES are 0xED); 238=hEE (Bits 7:0 of CRCERES are 0xEE); 239=hEF (Bits 7:0 of CRCERES are 0xEF); {v}=hF{v-240} (Bits 7:0 of CRCERES are {0x0+v}) (v=240..249); 250=hFA (Bits 7:0 of CRCERES are 0xFA); 251=hFB (Bits 7:0 of CRCERES are 0xFB); 252=hFC (Bits 7:0 of CRCERES are 0xFC); 253=hFD (Bits 7:0 of CRCERES are 0xFD); 254=hFE (Bits 7:0 of CRCERES are 0xFE); 255=hFF (Bits 7:0 of CRCERES are 0xFF)
