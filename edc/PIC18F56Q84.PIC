# PIC18F56Q84 register map
Vendor: Microchip
Architecture 18xxxx. Special function registers and configuration words.
Registers are 8-bit, read-write, reset 0x0 unless marked. A register's access mark holds for its fields unless they carry their own. Addresses are absolute, and some are shared; only a register's first bit layout is shown; lines under a group give offsets from that group; [hi:lo] are bit positions; {n}, {i} and the like mark numbered series; 'fields as' and 'values as' point back to an identical list; <NAME> marks a mode.

## Further device data
pins=1: ANC7/IOCC7/RC7; 2: AND4/RD4; 3: AND5/RD5; 4: AND6/RD6; 5: AND7/RD7; 6: VSS; 7: AVDD/VDD; 8: ZCD/ANB0/C2IN1+/IOCB0/RB0; 9: ANB1/C1IN3-/C2IN3-/SMB_I2C/IOCB1/RB1; 10: ANB2/SMB_I2C/IOCB2/RB2; 11: ANB3/C1IN2-/C2IN2-/IOCB3/RB3; 12: ANF4/RF4; 13: ANF5/RF5; 14: ANF6/RF6; 15: ANF7/RF7; 16: ANB4/IOCB4/RB4; 17: ANB5/IOCB5/RB5; 18: ICSPCLK/ICDCLK/ANB6/IOCB6/RB6; 19: ICSPDAT/ICDDAT/DAC1OUT/ANB7/ICOB7/RB7; 20: VPP/MCLR_n/ICDMCLR_n/IOCE3/RE3; 21: ANA0/C1IN0-/C2IN0-/IOCA0/RA0; 22: ANA1/C1IN1-/C2IN1-/IOCA1/RA1; 23: BOOTA2/DAC1OUT/VREF-/ANA2/C1IN0+/C2IN0+/IOCA2/RA2; 24: VREF+/ANA3/C1IN1+/IOCA3/RA3; 25: BOOTA4/ANA4/IOCA4/RA4; 26: ANA5/IOCA5/RA5; 27: ANE0/RE0; 28: ANE1/RE1; 29: ANE2/RE2; 30: VDD; 31: AVSS/VSS; 32: CLKIN/OSC1/ANA7/IOCA7/RA7; 33: OSC2/CLKOUT/ANA6/IOCA6/RA6; 34: SOSCO/ANC0/IOCC0/RC0; 35: SOSCI/ANC1/IOCC1/RC1; 36: ANF0/RF0; 37: ANF1/RF1; 38: ANF2/RF2; 39: ANF3/RF3; 40: ANC2/IOCC2/RC2; 41: ANC3/SMB_I2C/IOCC3/RC3; 42: AND0/SMB_I2C/RD0; 43: AND1/SMB_I2C/RD1; 44: AND2/RD2; 45: AND3/RD3; 46: BOOTC4/ANC4/SMB_I2C/IOCC4/RC4; 47: BOOTC5/ANC5/IOCC5/RC5; 48: ANC6/IOCC6/RC6, interrupts=0 SWINT — Software Interrupt; 1 HLVD — HLVD Interrupt; 2 OSF — Oscillator Failure Interrupt; 3 CSW — Clock Switch Interrupt; 4 TU16A — Universal Timer 16A Interrupt; 5 CLC1 — CLC1 Interrupt; 6 CAN — CAN FD Interrupt; 7 IOC — Interrupt on change; 8 INT0 — External Interrupt 0; 9 ZCD — ZCD Interrupt; 10 AD — ADC Interrupt; 11 ACT — ADC Treshold Interrupt; 12 CM1 — Comparator 1 Interrupt; 13 SMT1 — SMT1 Interrupt; 14 SMT1PRA; 15 SMT1PWA; 16 ADCH1 — ADC Threshold Interrupt-Context 0; 17 ADCH2 — ADC Threshold Interrupt-Context 1; 18 ADCH3 — ADC Threshold Interrupt-Context 2; 19 ADCH4 — ADC Threshold Interrupt-Context 3; 20 DMA1SCNT — DMA1 Source count Interrupt; 21 DMA1DCNT — DMA1 Destination count Interrupt; 22 DMA1OR — DMA1 Overflow Interrupt; 23 DMA1A — DMA1 Abort Interrupt; 24 SPI1RX — SPI1 Receive Interrupt; 25 SPI1TX — SPI1 Transmit Interrupt; 26 SPI1 — SPI1 Interrupt; 27 TMR2 — Timer 2 Interrupt; 28 TMR1 — Timer 1 Interrupt; 29 TMR1G — Timer 1 Gate Interrupt; 30 CCP1 — CCP1 Interrupt; 31 TMR0 — Timer0 Interrupt; 32 U1RX — UART1 Receive Interrupt; 33 U1TX — UART1 Transmit Interrupt; 34 U1E — UART1 Error Interrupt; 35 U1 — UART1 Interrupt; 36 CANRX — CAN FD Receive Interrupt; 37 CANTX — CAN FD Transmit Interrupt; 38 PWM1PR — PWM1 Period Interrupt; 39 PWM1 — PWM1 Interrupt; 40 SPI2RX — SPI2 Receive Interrupt; 41 SPI2TX — SPI2 Transmit Interrupt; 42 SPI2 — SPI 2 Interrupt; 43 TU16B — Universal Time 16B Interrupt; 44 TMR3 — Timer 3 Interrupt; 45 TMR3G — Timer 3 Gate Interrupt; 46 PWM2PR — PWM2 Period Interrupt; 47 PWM2 — PWM2 Interrupt; 48 INT1 — External Interrupt 1; 49 CLC2 — CLC2 Interrupt; 50 CWG1 — CWG 1 Interrupt; 51 NCO1 — NCO 1 Interrupt; 52 DMA2SCNT — DMA2 Source Count Interrupt; 53 DMA2DCNT — DMA2 Destination Count Interrupt; 54 DMA2OR — DMA2 Overflow Interrupt; 55 DMA2A — DMA2 Abort Interrupt; 56 I2C1RX — I2C1 Receive Interrupt; 57 I2C1TX — I2C1 Transmit Interrupt; 58 I2C1 — I2C1 General Interrupt; 59 I2C1E — I2C1 Error Interrupt; 61 CLC3 — CLC3 Interrupt; 62 PWM3PR — PWM3 Period Interrupt; 63 PWM3 — PWM3 Interrupt; 64 U2RX — UART2 Receive Interrupt; 65 U2TX — UART2 Transmit Interrupt; 66 U2E — UART2 Error Interrupt; 67 U2 — UART2 Interrupt; 68 TMR5 — Timer5 Interrupt; 69 TMR5G — Timer5 Gate Interrupt; 70 CCP2 — CCP2 Interrupt; 71 SCAN — Scanner Interrupt; 72 U3RX — UART3 Receive Interrupt; 73 U3TX — UART3 Transmit Interrupt; 74 U3E — UART3 Error Interrupt; 75 U3 — UART3 Interrupt; 77 CLC4 — CLC4 Interrupt; 78 PWM4PR — PWM4 Period Interrupt; 79 PWM4 — PWM4 Interrupt; 80 INT2 — External Interrupt 2; 81 CLC5 — CLC5 Interrupt; 82 CWG2 — CWG2 Interrupt; 83 NCO2 — NCO2 Interrupt; 84 DMA3SCNT — DMA3 Source count Interrupt; 85 DMA3DCNT — DMA3 Destination count Interrupt; 86 DMA3OR — DMA3 Overflow Interrupt; 87 DMA3A — DMA3 Abort Interrupt; 88 CCP3 — CCP3 Interrupt; 89 CLC6 — CLC6 Interrupt; 90 CWG3 — CWG3 Interrupt; 91 TMR4 — TMR4 Interrupt; 92 DMA4SCNT — DMA4 Source count Interrupt; 93 DMA4DCNT — DMA4 Destination count Interrupt; 94 DMA4OR — DMA4 Overflow Interrupt; 95 DMA4A — DMA4 Abort Interrupt; 96 U4RX — UART2 Receive Interrupt; 97 U4TX — UART 4 Transmit Interrupt; 98 U4E — UART4 Error Interrupt; 99 U4 — UART4 Interrupt; 100 DMA5SCNT — DMA5 Source Count Interrupt; 101 DMA5DCNT — DMA5 Destination Count Interrupt; 102 DMA5OR — DMA5 Overflow Interrupt; 103 DMA5A — DMA5 Abort Interrupt; 104 U5RX — UART5 Receive Interrupt; 105 U5TX — UART5 Transmit Interrupt; 106 U5E — UART5 Error Interrupt; 107 U5 — UART5 Interrupt; 108 DMA6SCNT — DMA6 Source Count Interrupt; 109 DMA6DCNT — DMA6 Destination Count Interrupt; 110 DMA6OR — DMA6 Overflow Interrupt; 111 DMA6A — DMA6 Abort Interrupt; 113 CLC7 — CLC7 Interrupt; 114 CM2 — Comparator 2 Interrupt; 115 NCO3 — NCO3 Interrupt; 116 DMA7SCNT — DMA7 Source Count Interrupt; 117 DMA7DCNT — DMA7 Destination Count Interrupt; 118 DMA7OR — DMA7 Overflow Interrupt; 119 DMA7A — DMA7 Abort Interrupt; 120 NVM — NVM Interrupt; 121 CLC8 — CLC8 Interrupt; 122 CRC — CRC Interrupt; 123 TMR6 — TMR6 Interrupt; 124 DMA8SCNT — DMA8 Source Count Interrupt; 125 DMA8DCNT — DMA8 Destination Count Interrupt; 126 DMA8OR — DMA8 Overflow Interrupt; 127 DMA8A — DMA8 Abort Interrupt
