# PIC18F14Q41 register map
Vendor: Microchip
Architecture 18xxxx. Special function registers and configuration words.
Registers are 8-bit, read-write, reset 0x0 unless marked. A register's access mark holds for its fields unless they carry their own. Addresses are absolute, and some are shared; only a register's first bit layout is shown; lines under a group give offsets from that group; [hi:lo] are bit positions; {n}, {i} and the like mark numbered series; 'fields as' and 'values as' point back to an identical list; <NAME> marks a mode.

## Further device data
pins=1: AVDD/VDD; 2: CLKIN/OSC1/SOSCI/ANA5/IOCA5/RA5; 3: CLKOUT/OSC2/SOSCO/ANA4/IOCA4/RA4; 4: VPP/MCLR_n/ICDMCLR_n/IOCA3/RA3; 5: ANC5/IOCC5/RC5; 6: ANC4/IOCC4/RC4; 7: OPA1IN1-/OPA1IN1+/C1IN3-/C2IN3-/ANC3/IOCC3/RC3; 8: ANC6/IOCC6/RC6; 9: ANC7/IOCC7/RC7; 10: ANB7/IOCB7/RB7; 11: SMB_I2C/ANB6/IOCB6/RB6; 12: OPA1IN0+/ANB5/IOCB5/RB5; 13: OPA1IN0-/SMB_I2C/ANB4/IOCB4/RB4; 14: OPA1OUT/C1IN2-/C2IN2-/ANC2/IOCC2/RC2; 15: C1IN1-/C2IN1-/ANC1/IOCC1/RC1; 16: C2IN0+/ANC0/IOCC0/RC0; 17: OPA1IN2-/OPA1IN2+/DAC1OUT2/VREF-/ZCD/ANA2/IOCA2/RA2; 18: C1IN0-/C2IN0-/VREF+/ICSPCLK/ICDCLK/ANA1/IOCA1/RA1; 19: DAC1OUT1/C1IN0+/ICSPDAT/ICDDAT/OPA1IN3-/OPA1IN3+/ANA0/IOCA0/RA0; 20: AVSS/VSS, interrupts=0 SWINT — Software Interrupt; 1 HLVD — HLVD Interrupt; 2 OSF — Oscillator Failure Interrupt; 3 CSW — Clock Switch Interrupt; 4 NVMIP; 5 CLC1 — CLC1 Interrupt; 6 CRC — CRC Interrupt; 7 IOC — Interrupt on change; 8 INT0 — External Interrupt 0; 9 ZCD — ZCD Interrupt; 10 AD — ADC Interrupt; 11 ACT — Active Clock Tuning Interrupt; 12 CMP1 — Comparator 1 Interrupt; 13 SMT1 — SMT1 Interrupt; 14 SMT1PRA — SMT1 Period acqusition Interrupt; 15 SMT1PWA — SMT1 Pulse width acqusition Interrupt; 16 ADT — ADC Threshold Interrupt; 20 DMA1SCNT — DMA1 Source count Interrupt; 21 DMA1DCNT — DMA1 Destination count Interrupt; 22 DMA1OR — DMA1 Overflow Interrupt; 23 DMA1A — DMA1 Abort Interrupt; 24 SPI1RX — SPI1 Receive Interrupt; 25 SPI1TX — SPI1 Transmit Interrupt; 26 SPI1 — SPI1 Interrupt; 27 TMR2 — Timer2 Interrupt; 28 TMR1 — Timer1 Interrupt; 29 TMR1G — Timer1 Gate Interrupt; 30 CCP1 — CCP1 Interrupt; 31 TMR0 — Timer0 Interrupt; 32 U1RX — UART1 Receive Interrupt; 33 U1TX — UART1 Transmit Interrupt; 34 U1E — UART1 Error Interrupt; 35 U1 — UART1 Interrupt; 36 TMR3 — Timer3 Interrupt; 37 TMR3G — Timer3 Gate Interrupt; 38 PWM1PR — PWM1 Period Interrupt; 39 PWM1 — PWM1 Interrupt; 40 SPI2RX — SPI2 Receive Interrupt; 41 SPI2TX — SPI2 Transmit Interrupt; 42 SPI2 — SPI2 Interrupt; 44 CMP2 — Comparator 2 Interrupt; 45 CLC2 — CLC2 Interrupt; 46 PWM2PR — PWM2 Period Interrupt; 47 PWM2 — PWM2 Interrupt; 48 INT1 — External Interrupt 1; 50 CWG1 — CWG Interrupt; 51 NCO1 — NCO1 Interrupt; 52 DMA2SCNT — DMA2 Source count Interrupt; 53 DMA2DCNT — DMA2 Destination count Interrupt; 54 DMA2OR — DMA2 Overflow Interrupt; 55 DMA2A — DMA2 Abort Interrupt; 56 I2C1RX — I2C1 Receive Interrupt; 57 I2C1TX — I2C1 Transmit Interrupt; 58 I2C1 — I2C1 Interrupt; 59 I2C1E — I2C1 Error Interrupt; 61 CLC3 — CLC3 Interrupt; 62 PWM3PR — PWM3 Period Interrupt; 63 PWM3 — PWM3 Interrupt; 64 U2RX — UART2 Receive Interrupt; 65 U2TX — UART2 Transmit Interrupt; 66 U2E — UART2 Error Interrupt; 67 U2 — UART2 Interrupt; 69 CLC4 — CLC4 Interrupt; 71 SCAN — Scanner Interrupt; 72 U3RX — UART3 Receive Interrupt; 73 U3TX — UART3 Transmit Interrupt; 74 U3E — UART3 Error Interrupt; 75 U3 — UART3 Interrupt; 76 DMA3SCNT — DMA3 Source count Interrupt; 77 DMA3DCNT — DMA3 Destination count Interrupt; 78 DMA3OR — DMA3 Overflow Interrupt; 79 DMA3A — DMA3 Abort Interrupt; 80 INT2 — External Interrupt 2; 83 TMR4 — Timer4 Interrupt; 84 DMA4SCNT — DMA4 Source count Interrupt; 85 DMA4DCNT — DMA4 Destination count Interrupt; 86 DMA4OR — DMA4 Overflow Interrupt; 87 DMA4A — DMA4 Abort Interrupt
