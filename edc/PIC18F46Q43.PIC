# PIC18F46Q43 register map
Vendor: Microchip
Architecture 18xxxx. Special function registers and configuration words.
Registers are 8-bit, read-write, reset 0x0 unless marked. A register's access mark holds for its fields unless they carry their own. Addresses are absolute, and some are shared; only a register's first bit layout is shown; lines under a group give offsets from that group; [hi:lo] are bit positions; {n}, {i} and the like mark numbered series; 'fields as' and 'values as' point back to an identical list; <NAME> marks a mode.

## Further device data
pins=1: VPP/MCLR_n/ICD_n/IOCE3/RE3; 2: ANA0/C1IN0-/C2IN0-/IOCA0/RA0; 3: ANA1/C1IN1-/C2IN1-/IOCA1/RA1; 4: DAC1OUT1/VREF-/ANA2/C1IN0+/C2IN0+/IOCA2/RA2; 5: VREF+/ANA3/C1IN1+/IOCA3/RA3; 6: ANA4/IOCA4/RA4; 7: ANA5/IOCA5/RA5; 8: ANE0/RE0; 9: ANE1/RE1; 10: ANE2/RE2; 11: VDD/AVDD; 12: VSS/AVSS; 13: CLKIN/OSC1/ANA7/IOCA7/RA7; 14: OSC2/CLKOUT/ANA6/IOCA6/RA6; 15: SOSCO/ANC0/IOCC0/RC0; 16: SOSCI/ANC1/IOCC1/RC1; 17: ANC2/IOCC2/RC2; 18: SMB_I2C/ANC3/IOCC3/RC3; 19: SMB_I2C/AND0/RD0; 20: SMB_I2C/AND1/RD1; 21: AND2/RD2; 22: AND3/RD3; 23: SMB_I2C/ANC4/IOCC4/RC4; 24: ANC5/IOCC5/RC5; 25: ANC6/IOCC6/RC6; 26: ANC7/IOCC7/RC7; 27: AND4/RD4; 28: AND5/RD5; 29: AND6/RD6; 30: AND7/RD7; 31: VSS; 32: VDD; 33: ZCD/ANB0/C2IN1+/IOCB0/RB0; 34: ANB1/C1IN3-/C2IN3-/SMB_I2C/IOCB1/RB1; 35: ANB2/SMB_I2C/IOCB2/RB2; 36: ANB3/C1IN2-/C2IN2-/IOCB3/RB3; 37: ANB4/IOCB4/RB4; 38: ANB5/IOCB5/RB5; 39: ICSPCLK/ICDCLK/ANB6/IOCB6/RB6; 40: ICSPDAT/ICDDAT/DAC1OUT2/ANB7/IOCB7/RB7, interrupts=0 SWINT — Software Interrupt; 1 HLVD — HLVD Interrupt; 2 OSF — Oscillator Failure Interrupt; 3 CSW — Clock Switch Interrupt; 5 CLC1 — CLC1 Interrupt; 7 IOC — Interrupt on change; 8 INT0 — External Interrupt 0; 9 ZCD — ZCD Interrupt; 10 AD — ADC Interrupt; 11 ACT — Active Clock Tuning Interrupt; 12 CMP1 — Comparator 1 Interrupt; 13 SMT1 — SMT1 Interrupt; 14 SMT1PRA — SMT1 Period acqusition Interrupt; 15 SMT1PRW — SMT1 Pulse width acqusition Interrupt; 16 ADT — ADC Treshold Interrupt; 20 DMA1SCNT — DMA1 Source count Interrupt; 21 DMA1DCNT — DMA1 Destination count Interrupt; 22 DMA1OR — DMA1 Overflow Interrupt; 23 DMA1A — DMA1 Abort Interrupt; 24 SPI1RX — SPI1 Receive Interrupt; 25 SPI1TX — SPI1 Transmit Interrupt; 26 SPI1 — SPI1 Interrupt; 27 TMR2 — Timer2 Interrupt; 28 TMR1 — Timer1 Interrupt; 29 TMR1G — Timer1 Gate Interrupt; 30 CCP1 — CCP1 Interrupt; 31 TMR0 — Timer0 Interrupt; 32 U1RX — UART1 Receive Interrupt; 33 U1TX — UART1 Transmit Interrupt; 34 U1E — UART1 Error Interrupt; 35 U1 — UART1 Interrupt; 38 PWM1PR — PWM1 Period Interrupt; 39 PWM1 — PWM1 Interrupt; 40 SPI2RX — SPI2 Receive Interrupt; 41 SPI2TX — SPI2 Transmit Interrupt; 42 SPI2 — SPI2 Interrupt; 44 TMR3 — Timer3 Interrupt; 45 TMR3G — Timer3 Gate Interrupt; 46 PWM2PR — PWM2 Period Interrupt; 47 PWM2 — PWM2 Interrupt; 48 INT1 — External Interrupt 1; 49 CLC2 — CLC2 Interrupt; 50 CWG1 — CWG1 Interrupt; 51 NCO1 — NCO1 Interrupt; 52 DMA2SCNT — DMA2 Source count Interrupt; 53 DMA2DCNT — DMA2 Destination count Interrupt; 54 DMA2OR — DMA2 Overflow Interrupt; 55 DMA2A — DMA2 Abort Interrupt; 56 I2C1RX — I2C1 Receive Interrupt; 57 I2C1TX — I2C1 Transmit Interrupt; 58 I2C1 — I2C1 Interrupt; 59 I2C1E — I2C1 Error Interrupt; 61 CLC3 — CLC3 Interrupt; 62 PWM3PR — PWM3 Period Interrupt; 63 PWM3 — PWM3 Interrupt; 64 U2RX — UART2 Receive Interrupt; 65 U2TX — UART2 Transmit Interrupt; 66 U2E — UART2 Error Interrupt; 67 U2 — UART2 Interrupt; 68 TMR5 — Timer5 Interrupt; 69 TMR5G — Timer5 Gate Interrupt; 70 CCP2 — CCP2 Interrupt; 71 SCAN — Scanner Interrupt; 72 U3RX — UART3 Receive Interrupt; 73 U3TX — UART3 Transmit Interrupt; 74 U3E — UART3 Error Interrupt; 75 U3 — UART3 Interrupt; 77 CLC4 — CLC4 Interrupt; 80 INT2 — External Interrupt 2; 81 CLC5 — CLC5 Interrupt; 82 CWG2 — CWG2 Interrupt; 83 NCO2 — NCO2 Interrupt; 84 DMA3SCNT — DMA3 Source count Interrupt; 85 DMA3DCNT — DMA3 Destination count Interrupt; 86 DMA3OR — DMA3 Overflow Interrupt; 87 DMA3A — DMA3 Abort Interrupt; 88 CCP3 — CCP3 Interrupt; 89 CLC6 — CLC6 Interrupt; 90 CWG3 — CWG3 Interrupt; 91 TMR4 — Timer4 Interrupt; 92 DMA4SCNT — DMA4 Source count Interrupt; 93 DMA4DCNT — DMA4 Destination count Interrupt; 94 DMA4OR — DMA4 Overflow Interrupt; 95 DMA4A — DMA4 Abort Interrupt; 96 U4RX — UART4 Receive Interrupt; 97 U4TX — UART4 Transmit Interrupt; 98 U4E — UART4 Error Interrupt; 99 U4 — UART4 Interrupt; 100 DMA5SCNT — DMA5 Source count Interrupt; 101 DMA5DCNT — DMA5 Destination count Interrupt; 102 DMA5OR — DMA5 Overflow Interrupt; 103 DMA5A — DMA5 Abort Interrupt; 104 U5RX — UART5 Receive Interrupt; 105 U5TX — UART5 Transmit Interrupt; 106 U5E — UART5 Error Interrupt; 107 U5 — UART5 Interrupt; 108 DMA6SCNT — DMA6 Source count Interrupt; 109 DMA6DCNT — DMA6 Destination count Interrupt; 110 DMA6OR — DMA6 Overflow Interrupt; 111 DMA6A — DMA6 Abort Interrupt; 113 CLC7 — CLC7 Interrupt; 114 CMP2 — Comparator 2 Interrupt; 115 NCO3 — NCO3 Interrupt; 120 NVM — NVM Interrupt; 121 CLC8 — CLC8 Interrupt; 122 CRC — CRC Interrupt; 123 TMR6 — Timer6 Interrupt
